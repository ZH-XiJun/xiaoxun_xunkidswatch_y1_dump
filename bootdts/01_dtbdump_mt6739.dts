/dts-v1/;

/ {
	#address-cells = <0x2>;
	#size-cells = <0x2>;
	compatible = "mediatek,mt6739";
	interrupt-parent = <0x1>;
	model = "mt6739";

	__symbols__ {
		DPIDLE = "/cpus/idle-states/dpidle";
		MCDI_CLUSTER = "/cpus/idle-states/mcdi-cluster";
		MCDI_CPU = "/cpus/idle-states/mcdi-cpu";
		SODI = "/cpus/idle-states/sodi";
		SODI3 = "/cpus/idle-states/sodi3";
		STANDBY = "/cpus/idle-states/standby";
		SUSPEND = "/cpus/idle-states/suspend";
		accdet = "/accdet";
		als = "/als_ps@0";
		apmixed = "/apmixed@1000c000";
		apuart0 = "/apuart0@11002000";
		apuart1 = "/apuart1@11003000";
		audgpio = "/mt_soc_dl1_pcm@11220000";
		audio = "/audio@11220000";
		auxadc = "/auxadc@11001000";
		bat_gm30 = "/bat_gm30";
		charger = "/charger";
		chosen = "/chosen";
		chr_stat = "/chr_stat";
		clk26m = "/clk26m";
		clk32k = "/clk32k";
		consys = "/consys@18070000";
		cpu0 = "/cpus/cpu@0";
		cpu1 = "/cpus/cpu@001";
		cpu2 = "/cpus/cpu@002";
		cpu3 = "/cpus/cpu@003";
		cpu_dbgapb = "/cpu_dbgapb";
		devinfo = "/devinfo";
		disp_aal0 = "/disp_aal0@1400f000";
		disp_mutex = "/disp_mutex@14001000";
		disp_ovl0 = "/disp_ovl0@1400a000";
		dispsys = "/dispsys@14000000";
		dsi_te = "/dsi_te";
		flashlight_core = "/flashlight_core";
		flashlights_rt4505 = "/flashlights_rt4505";
		gic = "/interrupt-controller@0c000000";
		goodix_fp = "/fingerprint";
		gpio = "/gpio@10005000";
		gpio_usage_mapping = "/gpio";
		gse_1 = "/gse_1";
		gyro = "/gyro";
		i2c0 = "/i2c@11007000";
		i2c1 = "/i2c@11008000";
		i2c2 = "/i2c@11009000";
		i2c3 = "/i2c@1100f000";
		i2c4 = "/i2c@11011000";
		i2c5 = "/i2c@11016000";
		imgsys_config = "/imgsys_config@15000000";
		infracfg_ao = "/infracfg_ao@10001000";
		irq_nfc = "/irq_nfc";
		irtx_pwm = "/irtx_pwm";
		kd_camera_hw1 = "/kd_camera_hw1@15008000";
		keypad = "/kp@10010000";
		main_pmic = "/pwrap@1000d000/pmic_irq";
		md1_sim1_hot_plug_eint = "/md1_sim1_hot_plug_eint";
		md1_sim2_hot_plug_eint = "/md1_sim2_hot_plug_eint";
		mdcldma = "/mdcldma@10014000";
		mdp_rdma0 = "/mdp_rdma0@14004000";
		mdp_rsz0 = "/mdp_rsz0@14005000";
		mdp_rsz1 = "/mdp_rsz1@14006000";
		mdp_tdshp0 = "/mdp_tdshp0@14009000";
		mdp_wdma0 = "/mdp_wdma0@14007000";
		mdp_wrot0 = "/mdp_wrot0@14008000";
		mm_mutex = "/mm_mutex@14016000";
		mmsys_config = "/mmsys_config@14000000";
		mrdump_ext_rst = "/mrdump_ext_rst";
		msdc0 = "/msdc@11230000";
		msdc0_pins_default = "/msdc@11230000/msdc0@default";
		msdc0_register_setting_default = "/msdc@11230000/msdc0@register_default";
		msdc1 = "/msdc@11240000";
		msdc1_ins = "/msdc1_ins";
		msdc1_pins_ddr50 = "/msdc@11240000/msdc1@ddr50";
		msdc1_pins_default = "/msdc@11240000/msdc1@default";
		msdc1_pins_sdr104 = "/msdc@11240000/msdc1@sdr104";
		msdc1_pins_sdr50 = "/msdc@11240000/msdc1@sdr50";
		msdc1_register_setting_default = "/msdc@11240000/msdc1@register_default";
		mse = "/mse";
		mt_charger = "/mt_charger";
		mt_pmic_vaud28_ldo_reg = "/mt_pmic_regulator/ldo_regulators/ldo_vaud28";
		mt_pmic_vaux18_ldo_reg = "/mt_pmic_regulator/ldo_regulators/ldo_vaux18";
		mt_pmic_vcama_ldo_reg = "/mt_pmic_regulator/ldo_regulators/ldo_vcama";
		mt_pmic_vcamd_ldo_reg = "/mt_pmic_regulator/ldo_regulators/ldo_vcamd";
		mt_pmic_vcamio_ldo_reg = "/mt_pmic_regulator/ldo_regulators/ldo_vcamio";
		mt_pmic_vcn18_ldo_reg = "/mt_pmic_regulator/ldo_regulators/ldo_vcn18";
		mt_pmic_vcn28_ldo_reg = "/mt_pmic_regulator/ldo_regulators/ldo_vcn28";
		mt_pmic_vcn33_bt_ldo_reg = "/mt_pmic_regulator/ldo_regulators/ldo_vcn33_bt";
		mt_pmic_vcn33_wifi_ldo_reg = "/mt_pmic_regulator/ldo_regulators/ldo_vcn33_wifi";
		mt_pmic_vcore_buck_reg = "/mt_pmic_regulator/buck_regulators/buck_vcore";
		mt_pmic_vdram_ldo_reg = "/mt_pmic_regulator/ldo_regulators/ldo_vdram";
		mt_pmic_vefuse_ldo_reg = "/mt_pmic_regulator/ldo_regulators/ldo_vefuse";
		mt_pmic_vemc_ldo_reg = "/mt_pmic_regulator/ldo_regulators/ldo_vemc";
		mt_pmic_vfe28_ldo_reg = "/mt_pmic_regulator/ldo_regulators/ldo_vfe28";
		mt_pmic_vibr_ldo_reg = "/mt_pmic_regulator/ldo_regulators/ldo_vibr";
		mt_pmic_vio18_ldo_reg = "/mt_pmic_regulator/ldo_regulators/ldo_vio18";
		mt_pmic_vio28_ldo_reg = "/mt_pmic_regulator/ldo_regulators/ldo_vio28";
		mt_pmic_vldo28_ldo_reg = "/mt_pmic_regulator/ldo_regulators/ldo_vldo28";
		mt_pmic_vmc_ldo_reg = "/mt_pmic_regulator/ldo_regulators/ldo_vmc";
		mt_pmic_vmch_ldo_reg = "/mt_pmic_regulator/ldo_regulators/ldo_vmch";
		mt_pmic_vmodem_buck_reg = "/mt_pmic_regulator/buck_regulators/buck_vmodem";
		mt_pmic_vpa_buck_reg = "/mt_pmic_regulator/buck_regulators/buck_vpa";
		mt_pmic_vproc_buck_reg = "/mt_pmic_regulator/buck_regulators/buck_vproc";
		mt_pmic_vrf12_ldo_reg = "/mt_pmic_regulator/ldo_regulators/ldo_vrf12";
		mt_pmic_vrf18_ldo_reg = "/mt_pmic_regulator/ldo_regulators/ldo_vrf18";
		mt_pmic_vs1_buck_reg = "/mt_pmic_regulator/buck_regulators/buck_vs1";
		mt_pmic_vsim1_ldo_reg = "/mt_pmic_regulator/ldo_regulators/ldo_vsim1";
		mt_pmic_vsim2_ldo_reg = "/mt_pmic_regulator/ldo_regulators/ldo_vsim2";
		mt_pmic_vsram_others_ldo_reg = "/mt_pmic_regulator/ldo_regulators/ldo_vsram_others";
		mt_pmic_vsram_proc_ldo_reg = "/mt_pmic_regulator/ldo_regulators/ldo_vsram_proc";
		mt_pmic_vusb33_ldo_reg = "/mt_pmic_regulator/ldo_regulators/ldo_vusb33";
		mt_pmic_vxo22_ldo_reg = "/mt_pmic_regulator/ldo_regulators/ldo_vxo22";
		mtkfb = "/mtkfb";
		nfc = "/nfc";
		odm = "/odm";
		otg_iddig = "/otg_iddig";
		pio = "/pinctrl@1000b000";
		pmic_clock_buffer_ctrl = "/pmic_clock_buffer_ctrl";
		reserved_memory = "/reserved-memory";
		rt9465_slave_chr = "/rt9465_slave_chr";
		scpsys = "/scpsys@10001000";
		smi_larb0 = "/smi_larb0@14003000";
		smi_larb1 = "/smi_larb1@17010000";
		smi_larb2 = "/smi_larb2@15001000";
		spi0 = "/spi@1100a000";
		spi1 = "/spi@11010000";
		spi2 = "/spi@11012000";
		syscfg_pctl_a = "/syscfg_pctl_a@10005000";
		syscfg_pctl_bl = "/syscfg_pctl_bl@10002600";
		syscfg_pctl_bm = "/syscfg_pctl_bm@10002800";
		syscfg_pctl_lb = "/syscfg_pctl_lb@10002400";
		syscfg_pctl_lm = "/syscfg_pctl_lm@10002200";
		syscfg_pctl_lt = "/syscfg_pctl_lt@10002000";
		syscfg_pctl_rb = "/syscfg_pctl_rb@10002a00";
		syscfg_pctl_rt = "/syscfg_pctl_bl@10002c00";
		sysirq = "/intpol-controller@0x10200620";
		topckgen = "/topckgen@10000000";
		touch = "/touch";
		venc = "/venc@17020000";
		venc_global_con = "/venc_global_con@17000000";
	};

	accdet {
		compatible = "mediatek,pmic-accdet";
		linux,phandle = <0x3d>;
		phandle = <0x3d>;
	};

	aes_top0@10016000 {
		compatible = "mediatek,aes_top0";
		reg = <0x0 0x10016000 0x0 0x1000>;
	};

	als_ps@0 {
		compatible = "mediatek,als_ps";
		linux,phandle = <0x5d>;
		phandle = <0x5d>;
	};

	amms_control {
		compatible = "mediatek,amms";
		interrupts = <0x0 0x7b 0x1>;
	};

	ap_ccif0@10209000 {
		compatible = "mediatek,ap_ccif0";
		interrupts = <0x0 0x94 0x8>;
		reg = <0x0 0x10209000 0x0 0x1000>;
	};

	ap_ccif1@1020b000 {
		compatible = "mediatek,ap_ccif1";
		interrupts = <0x0 0x96 0x8>;
		reg = <0x0 0x1020b000 0x0 0x1000>;
	};

	ap_dma@11000000 {
		compatible = "mediatek,ap_dma";
		interrupts = <0x0 0x52 0x8>;
		reg = <0x0 0x11000000 0x0 0x1000>;
	};

	apcldmain@1021b000 {
		compatible = "mediatek,apcldmain";
		reg = <0x0 0x1021b000 0x0 0x0>;
	};

	apcldmain@1021b100 {
		compatible = "mediatek,apcldmain";
		reg = <0x0 0x1021b100 0x0 0x0>;
	};

	apcldmain_ao@10014000 {
		compatible = "mediatek,apcldmain_ao";
		reg = <0x0 0x10014000 0x0 0x400>;
	};

	apcldmamisc@1021b800 {
		compatible = "mediatek,apcldmamisc";
		interrupts = <0x0 0xa5 0x4>;
		reg = <0x0 0x1021b800 0x0 0x0>;
	};

	apcldmamisc@1021b900 {
		compatible = "mediatek,apcldmamisc";
		reg = <0x0 0x1021b900 0x0 0x400>;
	};

	apcldmamisc_ao@10014800 {
		compatible = "mediatek,apcldmamisc_ao";
		reg = <0x0 0x10014800 0x0 0x400>;
	};

	apcldmamisc_ao@10014c00 {
		compatible = "mediatek,apcldmamisc_ao";
		reg = <0x0 0x10014c00 0x0 0x400>;
	};

	apcldmaout@1021b400 {
		compatible = "mediatek,apcldmaout";
		reg = <0x0 0x1021b400 0x0 0x0>;
	};

	apcldmaout@1021b500 {
		compatible = "mediatek,apcldmaout";
		reg = <0x0 0x1021b500 0x0 0x0>;
	};

	apcldmaout_ao@10014400 {
		compatible = "mediatek,apcldmaout_ao";
		reg = <0x0 0x10014400 0x0 0x400>;
	};

	apmixed@1000c000 {
		#clock-cells = <0x1>;
		compatible = "mediatek,apmixed", "mediatek,apmixedsys", "syscon";
		linux,phandle = <0x32>;
		phandle = <0x32>;
		reg = <0x0 0x1000c000 0x0 0x1000>;
	};

	apuart0@11002000 {
		cell-index = <0x0>;
		clock-div = <0x1>;
		clock-frequency = <0x18cba80>;
		clock-names = "uart0-main", "uart-apdma";
		clocks = <0x19 0x14 0x19 0x28>;
		compatible = "mediatek,mtk-uart";
		interrupts = <0x0 0x5b 0x8 0x0 0x68 0x8 0x0 0x69 0x8>;
		linux,phandle = <0x41>;
		phandle = <0x41>;
		reg = <0x0 0x11002000 0x0 0x1000 0x0 0x11000400 0x0 0x80 0x0 0x11000480 0x0 0x80>;
	};

	apuart1@11003000 {
		cell-index = <0x1>;
		clock-div = <0x1>;
		clock-frequency = <0x18cba80>;
		clock-names = "uart1-main";
		clocks = <0x19 0x15>;
		compatible = "mediatek,mtk-uart";
		interrupts = <0x0 0x5c 0x8 0x0 0x6a 0x8 0x0 0x6b 0x8>;
		linux,phandle = <0x42>;
		phandle = <0x42>;
		reg = <0x0 0x11003000 0x0 0x1000 0x0 0x11000500 0x0 0x80 0x0 0x11000580 0x0 0x80>;
	};

	apxgpt@10008000 {
		clocks = <0x18>;
		compatible = "mediatek,apxgpt";
		interrupts = <0x0 0xa6 0x8>;
		reg = <0x0 0x10008000 0x0 0x1000>;
	};

	atf_logger {
		compatible = "mediatek,atf_logger";
		interrupts = <0x0 0xf1 0x1>;
	};

	audio@11220000 {
		#clock-cells = <0x1>;
		compatible = "mediatek,audio", "syscon";
		linux,phandle = <0x31>;
		phandle = <0x31>;
		reg = <0x0 0x11220000 0x0 0x1000>;
	};

	audio_sram@11221000 {
		compatible = "mediatek,audio_sram";
		reg = <0x0 0x11221000 0x0 0x9000>;
	};

	auxadc@11001000 {
		clock-names = "auxadc-main";
		clocks = <0x19 0x22>;
		compatible = "mediatek,auxadc";
		interrupts = <0x0 0x4a 0x2>;
		linux,phandle = <0x40>;
		phandle = <0x40>;
		reg = <0x0 0x11001000 0x0 0x1000>;
	};

	bat_gm30 {
		CAR_TUNE_VALUE = <0x63>;
		DIFFERENCE_FULLOCV_ITH = <0x64>;
		EMBEDDED_SEL = <0x1>;
		FG_METER_RESISTANCE = <0x4b>;
		KEEP_100_PERCENT = <0x3>;
		PMIC_SHUTDOWN_CURRENT = <0x6>;
		Q_MAX_SYS_VOLTAGE_BAT0 = <0xd48>;
		Q_MAX_SYS_VOLTAGE_BAT1 = <0xd48>;
		Q_MAX_SYS_VOLTAGE_BAT2 = <0xd48>;
		Q_MAX_SYS_VOLTAGE_BAT3 = <0xd48>;
		R_FG_VALUE = <0xa>;
		SHUTDOWN_1_TIME = <0x3c>;
		TEMPERATURE_T0 = <0x32>;
		TEMPERATURE_T1 = <0x19>;
		TEMPERATURE_T2 = <0xa>;
		TEMPERATURE_T3 = <0x0>;
		TEMPERATURE_T4 = <0xfffffff6>;
		battery0_profile_t0 = <0x0 0xaab4 0x99c 0x4a 0xa9f2 0x965 0x94 0xa95a 0x960 0xde 0xa8c6 0x960 0x128 0xa838 0x960 0x172 0xa7b6 0x960 0x1bc 0xa739 0x96c 0x206 0xa6b7 0x988 0x250 0xa638 0x988 0x299 0xa5c5 0x988 0x2e3 0xa545 0x988 0x32d 0xa4cb 0x988 0x377 0xa453 0x9a5 0x3c1 0xa3e4 0x9b0 0x40b 0xa373 0x9b0 0x455 0xa2fe 0x9cd 0x49f 0xa291 0xa00 0x4e9 0xa225 0xa00 0x533 0xa1ad 0xa00 0x57d 0xa13e 0xa25 0x5c7 0xa0da 0xa47 0x611 0xa068 0xa50 0x65b 0x9ff6 0xa50 0x6a5 0x9f92 0xa62 0x6ef 0x9f31 0xa78 0x738 0x9ec5 0xa81 0x782 0x9e61 0xaa6 0x7cc 0x9e06 0xac6 0x816 0x9da1 0xaeb 0x860 0x9d34 0xad0 0x8aa 0x9cdb 0xae2 0x8f4 0x9c83 0xb05 0x93e 0x9c27 0xb2a 0x988 0x9bcb 0xb40 0x9d2 0x9b71 0xb40 0xa1c 0x9b1f 0xb44 0xa66 0x9acc 0xb69 0xab0 0x9a79 0xb8e 0xafa 0x9a2e 0xb90 0xb44 0x99de 0xb90 0xb8e 0x9985 0xb90 0xbd8 0x992e 0xb7e 0xc21 0x98cf 0xb35 0xc6b 0x9854 0xaa1 0xcb5 0x97da 0xa1c 0xcff 0x977f 0x9da 0xd49 0x9723 0x991 0xd93 0x96d7 0x988 0xddd 0x969a 0x988 0xe27 0x965c 0x972 0xe71 0x9625 0x972 0xebb 0x95f2 0x988 0xf05 0x95bb 0x988 0xf4f 0x958b 0x988 0xf99 0x9555 0x98b 0xfe3 0x9530 0x9d5 0x102d 0x9507 0x9d8 0x1077 0x94e1 0x9f3 0x10c0 0x94b6 0xa00 0x110a 0x948f 0xa00 0x1154 0x946d 0xa0d 0x119e 0x9448 0xa28 0x11e8 0x9425 0xa2e 0x1232 0x940d 0xa4f 0x127c 0x93e8 0xa50 0x12c6 0x93cb 0xa71 0x1310 0x93b2 0xa78 0x135a 0x9392 0xa62 0x13a4 0x936d 0xa50 0x13ee 0x9343 0xa34 0x1438 0x930a 0x9e8 0x1482 0x92ba 0x988 0x14cc 0x927a 0x98a 0x1516 0x925a 0x9aa 0x1560 0x922e 0x9b0 0x15a9 0x91ff 0x994 0x15f3 0x91d1 0x988 0x163d 0x91ab 0x988 0x1687 0x9188 0x996 0x16d1 0x9163 0x9bb 0x171b 0x913e 0x9df 0x1765 0x9115 0xa00 0x17af 0x90cb 0x9b7 0x17f9 0x9092 0x9d1 0x1843 0x9059 0x9d8 0x188d 0x9015 0x9d8 0x18d7 0x8fcb 0x99e 0x1921 0x8f9b 0x97d 0x196b 0x8f8c 0x9c1 0x19b5 0x8f83 0xa15 0x19ff 0x8f78 0xaa4 0x1a48 0x8f60 0xae6 0x1a92 0x8f35 0xb6d 0x1adc 0x8e81 0xb3b 0x1b26 0x8d4f 0xb5b 0x1b70 0x8b9e 0xbd4 0x1bba 0x8958 0xdf3 0x1c04 0x8677 0x181a 0x1c4e 0x81b4 0x34c3 0x1c98 0x74c2 0x3de0>;
		battery0_profile_t0_num = <0x64>;
		battery0_profile_t1 = <0x0 0xa9ba 0x10ea 0x4a 0xa901 0xf4a 0x94 0xa872 0xf46 0xde 0xa7e7 0xf6a 0x128 0xa762 0xf8f 0x172 0xa6e8 0xfa0 0x1bc 0xa671 0xfa0 0x206 0xa5ef 0xfa0 0x250 0xa571 0xfa5 0x299 0xa507 0xfc6 0x2e3 0xa48f 0xfeb 0x32d 0xa417 0xff0 0x377 0xa39f 0xff0 0x3c1 0xa330 0x1007 0x40b 0xa2c3 0x102a 0x455 0xa251 0x1040 0x49f 0xa1df 0x104a 0x4e9 0xa17c 0x106b 0x533 0xa10d 0x1090 0x57d 0xa09e 0x10b5 0x5c7 0xa03a 0x10d7 0x611 0x9fcf 0x10e0 0x65b 0x9f6c 0x110f 0x6a5 0x9f22 0x1166 0x6ef 0x9ee0 0x11b4 0x738 0x9e7f 0x11c7 0x782 0x9df5 0x11a2 0x7cc 0x9d69 0x1182 0x816 0x9cd5 0x1180 0x860 0x9c62 0x11a0 0x8aa 0x9c10 0x11a8 0x8f4 0x9bc6 0x11bd 0x93e 0x9b7c 0x11d0 0x988 0x9b32 0x11d0 0x9d2 0x9aeb 0x11db 0xa1c 0x9aa7 0x11f4 0xa66 0x9a54 0x11d2 0xab0 0x9a0a 0x121c 0xafa 0x99a1 0x11a4 0xb44 0x9934 0x114a 0xb8e 0x98c5 0x10e9 0xbd8 0x985d 0x106e 0xc21 0x97f9 0xfff 0xc6b 0x9796 0xfb5 0xcb5 0x973e 0xf72 0xcff 0x96fc 0xf51 0xd49 0x96b3 0xf50 0xd93 0x9671 0xf2f 0xddd 0x9643 0xf42 0xe27 0x9612 0xf50 0xe71 0x95df 0xf62 0xebb 0x95af 0xf78 0xf05 0x957f 0xf78 0xf4f 0x9552 0xf7c 0xf99 0x952c 0xfa0 0xfe3 0x94fe 0xfa0 0x102d 0x94dd 0xfa0 0x1077 0x94b9 0xfbb 0x10c0 0x9494 0xfc8 0x110a 0x9476 0xfdb 0x1154 0x9459 0xff0 0x119e 0x9436 0xffa 0x11e8 0x941a 0x1018 0x1232 0x93f9 0x1018 0x127c 0x93dd 0x1018 0x12c6 0x93c1 0x1018 0x1310 0x93a8 0x1018 0x135a 0x9388 0x1002 0x13a4 0x9368 0x1003 0x13ee 0x934a 0x100a 0x1438 0x9328 0xff0 0x1482 0x9302 0xfeb 0x14cc 0x92d4 0xfc8 0x1516 0x92b4 0xfc8 0x1560 0x928f 0xfc8 0x15a9 0x926a 0xfe4 0x15f3 0x9245 0xff0 0x163d 0x9223 0x1003 0x1687 0x91fd 0x1018 0x16d1 0x91c9 0x1018 0x171b 0x918a 0x1018 0x1765 0x9151 0x1018 0x17af 0x9119 0x103d 0x17f9 0x90d9 0x1061 0x1843 0x908a 0x1032 0x188d 0x904e 0x102e 0x18d7 0x9029 0x1053 0x1921 0x9016 0x1094 0x196b 0x900e 0x1101 0x19b5 0x9002 0x1195 0x19ff 0x8fe4 0x122a 0x1a48 0x8fab 0x12ce 0x1a92 0x8eb0 0x126b 0x1adc 0x8d13 0x1346 0x1b26 0x8b0c 0x1490 0x1b70 0x8856 0x1696 0x1bba 0x8510 0x1fce 0x1c04 0x7e74 0x5112 0x1c4e 0x79e0 0x5190 0x1c98 0x79e0 0x5190>;
		battery0_profile_t1_num = <0x64>;
		battery0_profile_t2 = <0x0 0xa9ba 0x186a 0x4a 0xa7a2 0x150e 0x94 0xa6b9 0x1d62 0xde 0xa60e 0x20e5 0x128 0xa57c 0x2176 0x172 0xa4fe 0x21bb 0x1bc 0xa48a 0x21f4 0x206 0xa411 0x2222 0x250 0xa39b 0x2260 0x299 0xa331 0x2260 0x2e3 0xa2c2 0x22a5 0x32d 0xa24b 0x22d0 0x377 0xa1da 0x22f5 0x3c1 0xa16e 0x2317 0x40b 0xa101 0x234b 0x455 0xa092 0x2387 0x49f 0xa027 0x23a0 0x4e9 0x9fc7 0x23aa 0x533 0x9f7d 0x241a 0x57d 0x9f46 0x24d3 0x5c7 0x9eee 0x24e0 0x611 0x9e64 0x24c6 0x65b 0x9db5 0x2489 0x6a5 0x9d11 0x247a 0x6ef 0x9c80 0x2490 0x738 0x9bff 0x2499 0x782 0x9b9f 0x24c3 0x7cc 0x9b5d 0x2505 0x816 0x9b14 0x252b 0x860 0x9aca 0x2530 0x8aa 0x9a80 0x2516 0x8f4 0x9a2b 0x24f3 0x93e 0x99c1 0x2498 0x988 0x994d 0x2413 0x9d2 0x98e2 0x23b3 0xa1c 0x9880 0x2374 0xa66 0x9824 0x2350 0xab0 0x97c7 0x2350 0xafa 0x977c 0x2331 0xb44 0x9739 0x2343 0xb8e 0x96f8 0x2350 0xbd8 0x96bc 0x2362 0xc21 0x9683 0x2385 0xc6b 0x964b 0x23b3 0xcb5 0x9615 0x23f0 0xcff 0x95e4 0x23f0 0xd49 0x95b5 0x2437 0xd93 0x957f 0x2440 0xddd 0x955a 0x248f 0xe27 0x9531 0x24ce 0xe71 0x9508 0x2505 0xebb 0x94e4 0x254b 0xf05 0x94c3 0x258f 0xf4f 0x949e 0x25d4 0xf99 0x9479 0x25fb 0xfe3 0x9454 0x2645 0x102d 0x9433 0x2667 0x1077 0x9416 0x268b 0x10c0 0x93fa 0x26c8 0x110a 0x93db 0x26fb 0x1154 0x93bc 0x271d 0x119e 0x939e 0x2742 0x11e8 0x937b 0x2766 0x1232 0x9363 0x2787 0x127c 0x9347 0x27ac 0x12c6 0x9323 0x27b0 0x1310 0x9301 0x27cb 0x135a 0x92de 0x27ee 0x13a4 0x92b9 0x2813 0x13ee 0x9296 0x2844 0x1438 0x9272 0x2890 0x1482 0x9243 0x28fa 0x14cc 0x920b 0x2942 0x1516 0x91c9 0x2962 0x1560 0x9190 0x29c4 0x15a9 0x9151 0x2a33 0x15f3 0x9104 0x2a89 0x163d 0x90bb 0x2acf 0x1687 0x9088 0x2b4a 0x16d1 0x906f 0x2c28 0x171b 0x905d 0x2d0e 0x1765 0x904c 0x2e15 0x17af 0x903a 0x2f85 0x17f9 0x9017 0x315b 0x1843 0x8f8f 0x32bf 0x188d 0x8e50 0x347a 0x18d7 0x8c50 0x37c9 0x1921 0x89c6 0x3ddc 0x196b 0x866a 0x4832 0x19b5 0x8098 0x59d0 0x19ff 0x799a 0x5438 0x1a48 0x799a 0x5438 0x1a92 0x799a 0x5438 0x1adc 0x799a 0x5438 0x1b26 0x799a 0x5438 0x1b70 0x799a 0x5438 0x1bba 0x799a 0x5438 0x1c04 0x799a 0x5438 0x1c4e 0x799a 0x5438 0x1c98 0x799a 0x5438>;
		battery0_profile_t2_num = <0x64>;
		battery0_profile_t3 = <0x0 0xa97e 0x3cdc 0x4a 0xa803 0x3ca5 0x94 0xa709 0x44c2 0xde 0xa647 0x4a24 0x128 0xa5a8 0x4bfc 0x172 0xa522 0x4c1d 0x1bc 0xa4a5 0x4bcd 0x206 0xa425 0x4b66 0x250 0xa3af 0x4b19 0x299 0xa345 0x4ab6 0x2e3 0xa2cd 0x4a6b 0x32d 0xa255 0x4a21 0x377 0xa1dd 0x49ba 0x3c1 0xa174 0x496a 0x40b 0xa107 0x4936 0x455 0xa08f 0x4903 0x49f 0xa022 0x48c6 0x4e9 0x9fd2 0x48a5 0x533 0x9f91 0x4880 0x57d 0x9f47 0x48a5 0x5c7 0x9ed7 0x486b 0x611 0x9e32 0x4809 0x65b 0x9d6e 0x47b1 0x6a5 0x9cbc 0x47a2 0x6ef 0x9c23 0x47b8 0x738 0x9b96 0x47af 0x782 0x9b23 0x47a1 0x7cc 0x9ac8 0x4803 0x816 0x9a6c 0x4808 0x860 0x9a18 0x4848 0x8aa 0x99c5 0x47f1 0x8f4 0x9973 0x4764 0x93e 0x991f 0x474e 0x988 0x98c9 0x4781 0x9d2 0x9872 0x473d 0xa1c 0x9827 0x46c4 0xa66 0x97d4 0x46a2 0xab0 0x978a 0x46ec 0xafa 0x9748 0x474d 0xb44 0x9707 0x47b8 0xb8e 0x96c6 0x47b0 0xbd8 0x968a 0x4790 0xc21 0x9651 0x47dc 0xc6b 0x9619 0x4880 0xcb5 0x95e5 0x4898 0xcff 0x95bc 0x491b 0xd49 0x958d 0x498b 0xd93 0x955f 0x49d9 0xddd 0x9535 0x4a1d 0xe27 0x9509 0x4a63 0xe71 0x94e0 0x4af7 0xebb 0x94bc 0x4b93 0xf05 0x9499 0x4bd7 0xf4f 0x946d 0x4c1c 0xf99 0x9450 0x4c45 0xfe3 0x9422 0x4cd9 0x102d 0x9408 0x4ce0 0x1077 0x93e7 0x4cfb 0x10c0 0x93c2 0x4d20 0x110a 0x93a4 0x4d56 0x1154 0x938a 0x4d80 0x119e 0x936e 0x4da9 0x11e8 0x9353 0x4e33 0x1232 0x933b 0x4e96 0x127c 0x931f 0x4f04 0x12c6 0x92fb 0x4f94 0x1310 0x92d9 0x5035 0x135a 0x92b1 0x50e6 0x13a4 0x9282 0x519f 0x13ee 0x9253 0x5287 0x1438 0x9220 0x53af 0x1482 0x91e8 0x54c8 0x14cc 0x91a7 0x558b 0x1516 0x9165 0x5716 0x1560 0x911c 0x58e8 0x15a9 0x90d9 0x5ac8 0x15f3 0x90b1 0x5d0c 0x163d 0x9098 0x5f6b 0x1687 0x9081 0x6235 0x16d1 0x9069 0x65f1 0x171b 0x903d 0x69ca 0x1765 0x8ff3 0x6cde 0x17af 0x8f05 0x700b 0x17f9 0x8d43 0x737c 0x1843 0x8b00 0x752e 0x188d 0x887c 0x6f20 0x18d7 0x8421 0x7a95 0x1921 0x7df0 0x61a8 0x196b 0x7df0 0x61a8 0x19b5 0x7df0 0x61a8 0x19ff 0x7df0 0x61a8 0x1a48 0x7df0 0x61a8 0x1a92 0x7df0 0x61a8 0x1adc 0x7df0 0x61a8 0x1b26 0x7df0 0x61a8 0x1b70 0x7df0 0x61a8 0x1bba 0x7df0 0x61a8 0x1c04 0x7df0 0x61a8 0x1c4e 0x7df0 0x61a8 0x1c98 0x7df0 0x61a8>;
		battery0_profile_t3_num = <0x64>;
		battery0_profile_t4 = <0x0 0xa97e 0x3cdc 0x4a 0xa803 0x3ca5 0x94 0xa709 0x44c2 0xde 0xa647 0x4a24 0x128 0xa5a8 0x4bfc 0x172 0xa522 0x4c1d 0x1bc 0xa4a5 0x4bcd 0x206 0xa425 0x4b66 0x250 0xa3af 0x4b19 0x299 0xa345 0x4ab6 0x2e3 0xa2cd 0x4a6b 0x32d 0xa255 0x4a21 0x377 0xa1dd 0x49ba 0x3c1 0xa174 0x496a 0x40b 0xa107 0x4936 0x455 0xa08f 0x4903 0x49f 0xa022 0x48c6 0x4e9 0x9fd2 0x48a5 0x533 0x9f91 0x4880 0x57d 0x9f47 0x48a5 0x5c7 0x9ed7 0x486b 0x611 0x9e32 0x4809 0x65b 0x9d6e 0x47b1 0x6a5 0x9cbc 0x47a2 0x6ef 0x9c23 0x47b8 0x738 0x9b96 0x47af 0x782 0x9b23 0x47a1 0x7cc 0x9ac8 0x4803 0x816 0x9a6c 0x4808 0x860 0x9a18 0x4848 0x8aa 0x99c5 0x47f1 0x8f4 0x9973 0x4764 0x93e 0x991f 0x474e 0x988 0x98c9 0x4781 0x9d2 0x9872 0x473d 0xa1c 0x9827 0x46c4 0xa66 0x97d4 0x46a2 0xab0 0x978a 0x46ec 0xafa 0x9748 0x474d 0xb44 0x9707 0x47b8 0xb8e 0x96c6 0x47b0 0xbd8 0x968a 0x4790 0xc21 0x9651 0x47dc 0xc6b 0x9619 0x4880 0xcb5 0x95e5 0x4898 0xcff 0x95bc 0x491b 0xd49 0x958d 0x498b 0xd93 0x955f 0x49d9 0xddd 0x9535 0x4a1d 0xe27 0x9509 0x4a63 0xe71 0x94e0 0x4af7 0xebb 0x94bc 0x4b93 0xf05 0x9499 0x4bd7 0xf4f 0x946d 0x4c1c 0xf99 0x9450 0x4c45 0xfe3 0x9422 0x4cd9 0x102d 0x9408 0x4ce0 0x1077 0x93e7 0x4cfb 0x10c0 0x93c2 0x4d20 0x110a 0x93a4 0x4d56 0x1154 0x938a 0x4d80 0x119e 0x936e 0x4da9 0x11e8 0x9353 0x4e33 0x1232 0x933b 0x4e96 0x127c 0x931f 0x4f04 0x12c6 0x92fb 0x4f94 0x1310 0x92d9 0x5035 0x135a 0x92b1 0x50e6 0x13a4 0x9282 0x519f 0x13ee 0x9253 0x5287 0x1438 0x9220 0x53af 0x1482 0x91e8 0x54c8 0x14cc 0x91a7 0x558b 0x1516 0x9165 0x5716 0x1560 0x911c 0x58e8 0x15a9 0x90d9 0x5ac8 0x15f3 0x90b1 0x5d0c 0x163d 0x9098 0x5f6b 0x1687 0x9081 0x6235 0x16d1 0x9069 0x65f1 0x171b 0x903d 0x69ca 0x1765 0x8ff3 0x6cde 0x17af 0x8f05 0x700b 0x17f9 0x8d43 0x737c 0x1843 0x8b00 0x752e 0x188d 0x887c 0x6f20 0x18d7 0x8421 0x7a95 0x1921 0x7df0 0x61a8 0x196b 0x7df0 0x61a8 0x19b5 0x7df0 0x61a8 0x19ff 0x7df0 0x61a8 0x1a48 0x7df0 0x61a8 0x1a92 0x7df0 0x61a8 0x1adc 0x7df0 0x61a8 0x1b26 0x7df0 0x61a8 0x1b70 0x7df0 0x61a8 0x1bba 0x7df0 0x61a8 0x1c04 0x7df0 0x61a8 0x1c4e 0x7df0 0x61a8 0x1c98 0x7df0 0x61a8>;
		battery0_profile_t4_num = <0x64>;
		compatible = "mediatek,bat_gm30";
		g_FG_PSEUDO100_T0 = <0x62>;
		g_FG_PSEUDO100_T1 = <0x62>;
		g_FG_PSEUDO100_T2 = <0x5f>;
		g_FG_PSEUDO100_T3 = <0x5a>;
		g_FG_PSEUDO100_T4 = <0x50>;
		linux,phandle = <0x57>;
		phandle = <0x57>;
	};

	bpi_bsi_slv0@1021e000 {
		compatible = "mediatek,bpi_bsi_slv0";
		reg = <0x0 0x1021e000 0x0 0x1000>;
	};

	bpi_bsi_slv1@1021f000 {
		compatible = "mediatek,bpi_bsi_slv1";
		reg = <0x0 0x1021f000 0x0 0x6000>;
	};

	bpi_bsi_slv2@10225000 {
		compatible = "mediatek,bpi_bsi_slv2";
		reg = <0x0 0x10225000 0x0 0x1000>;
	};

	btcvsd@10001000 {
		compatible = "mediatek,audio_bt_cvsd";
		interrupts = <0x0 0xe8 0x8>;
		offset = <0xf00 0x800 0xfd0 0xfd4 0xfd8>;
		reg = <0x0 0x10001000 0x0 0x1000 0x0 0x18000000 0x0 0x10000 0x0 0x18080000 0x0 0x8000>;
	};

	btif@1100c000 {
		#address-cells = <0x2>;
		#size-cells = <0x2>;
		clock-names = "btifc", "apdmac";
		clocks = <0x19 0x1a 0x19 0x28>;
		compatible = "mediatek,btif";
		interrupts = <0x0 0x70 0x8 0x0 0x6c 0x8 0x0 0x6d 0x8>;
		reg = <0x0 0x1100c000 0x0 0x1000 0x0 0x11000600 0x0 0x80 0x0 0x11000680 0x0 0x80>;
	};

	bus_dbg@10208000 {
		compatible = "mediatek,bus_dbg-v2";
		interrupts = <0x0 0x8d 0x8>;
		mediatek,bus_dbg_con_offset = <0x2fc>;
		reg = <0x0 0x10208000 0x0 0x1000 0x0 0x10001000 0x0 0x1000>;
	};

	cam_a@15004000 {
		compatible = "mediatek,cam_a";
		reg = <0x0 0x15004000 0x0 0x1000>;
	};

	cam_a_inner@1500d000 {
		compatible = "mediatek,cam_a_inner";
		reg = <0x0 0x1500d000 0x0 0x1000>;
	};

	cam_b@15005000 {
		compatible = "mediatek,cam_b";
		interrupts = <0x0 0xd9 0x8>;
		reg = <0x0 0x15005000 0x0 0x1000>;
	};

	cam_c@15006000 {
		compatible = "mediatek,cam_c";
		interrupts = <0x0 0xda 0x8>;
		reg = <0x0 0x15006000 0x0 0x1000>;
	};

	cam_c_inner@1500e000 {
		compatible = "mediatek,cam_c_inner";
		reg = <0x0 0x1500e000 0x0 0x1000>;
	};

	cam_d@15007000 {
		compatible = "mediatek,cam_d";
		interrupts = <0x0 0xdb 0x8>;
		reg = <0x0 0x15007000 0x0 0x1000>;
	};

	cam_d_inner@1500f000 {
		compatible = "mediatek,cam_d_inner";
		reg = <0x0 0x1500f000 0x0 0x1000>;
	};

	camsv@15009000 {
		compatible = "mediatek,camsv";
		interrupts = <0x0 0xdc 0x8>;
		reg = <0x0 0x15009000 0x0 0x1000>;
	};

	charger {
		ac_charger_current = <0xb4aa0>;
		ac_charger_input_current = <0x16e360>;
		algorithm_name = "SwitchCharging";
		apple_1_0a_charger_current = <0x7a120>;
		apple_2_1a_charger_current = <0x7a120>;
		battery_cv = <0x432380>;
		bif_cv_under_threshold2 = <0x43e6d0>;
		bif_threshold1 = <0x40d990>;
		bif_threshold2 = <0x419ce0>;
		cable_imp_threshold = <0x2bb>;
		charging_host_charger_current = <0x7a120>;
		chg1_ta_ac_charger_current = <0x16e360>;
		chg2_ta_ac_charger_current = <0x16e360>;
		chg_full_current = <0x13880>;
		compatible = "mediatek,charger";
		enable_min_charge_temperature;
		enable_sw_jeita;
		enable_sw_safety_timer;
		jeita_temp_above_t4_cv_voltage = <0x40d990>;
		jeita_temp_below_t0_cv_voltage = <0x3dcc50>;
		jeita_temp_t0_to_t1_cv_voltage = <0x432380>;
		jeita_temp_t1_to_t2_cv_voltage = <0x432380>;
		jeita_temp_t2_to_t3_cv_voltage = <0x432380>;
		jeita_temp_t3_to_t4_cv_voltage = <0x432380>;
		linux,phandle = <0x59>;
		max_charge_temperature = <0x32>;
		max_charge_temperature_minus_x_degree = <0x2c>;
		max_charger_voltage = <0x632ea0>;
		max_charging_time = <0xa8c0>;
		min_charge_temperature = <0x0>;
		min_charge_temperature_plus_x_degree = <0x2>;
		non_std_ac_charger_current = <0x7a120>;
		pe20_ichg_level_threshold = <0x3e8>;
		phandle = <0x59>;
		recharge_offset = <0x186a0>;
		ta_ac_charger_current = <0x2dc6c0>;
		ta_start_battery_soc = <0x0>;
		ta_stop_battery_soc = <0x55>;
		temp_t0_threshold = <0x0>;
		temp_t1_threshold = <0x14>;
		temp_t2_threshold = <0x28>;
		temp_t3_threshold = <0x2d>;
		temp_t4_threshold = <0x2e>;
		topoff_voltage = <0x40d990>;
		usb_charger_current = <0x7ef40>;
		usb_charger_current_configured = <0x7ef40>;
		usb_charger_current_suspend = <0x0>;
		usb_charger_current_unconfigured = <0x11170>;
		vbat_cable_imp_threshold = <0xf3c>;
	};

	chipid@08000000 {
		compatible = "mediatek,chipid";
		reg = <0x0 0x8000000 0x0 0x4 0x0 0x8000004 0x0 0x4 0x0 0x8000008 0x0 0x4 0x0 0x800000c 0x0 0x4>;
	};

	chosen {
		bootargs = "console=tty0 console=ttyMT0,921600n1 root=/dev/ram initrd=0x44000000,0x1000000 loglevel=8 androidboot.selinux=permissive";
		linux,phandle = <0x38>;
		phandle = <0x38>;
	};

	chr_stat {
		linux,phandle = <0x63>;
		phandle = <0x63>;
	};

	clk26m {
		#clock-cells = <0x0>;
		clock-frequency = <0x18cba80>;
		compatible = "fixed-clock";
		linux,phandle = <0x25>;
		phandle = <0x25>;
	};

	clk32k {
		#clock-cells = <0x0>;
		clock-frequency = <0x7d00>;
		compatible = "fixed-clock";
		linux,phandle = <0x18>;
		phandle = <0x18>;
	};

	consys@18070000 {
		#address-cells = <0x2>;
		#size-cells = <0x2>;
		clock-names = "conn";
		clocks = <0x1a 0x3>;
		compatible = "mediatek,mt6739-consys";
		interrupts = <0x0 0xe9 0x8 0x0 0xeb 0x2>;
		linux,phandle = <0x5b>;
		phandle = <0x5b>;
		reg = <0x0 0x18070000 0x0 0x200 0x0 0x10007000 0x0 0x100 0x0 0x10000000 0x0 0x2000 0x0 0x10006000 0x0 0x1000>;
	};

	cpu_dbgapb {
		compatible = "mediatek,hw_dbg";
		linux,phandle = <0x39>;
		num = <0x4>;
		phandle = <0x39>;
		reg = <0x0 0xd410000 0x0 0x1000 0x0 0xd510000 0x0 0x1000 0x0 0xd610000 0x0 0x1000 0x0 0xd710000 0x0 0x1000>;
	};

	cpus {
		#address-cells = <0x1>;
		#size-cells = <0x0>;

		cpu-map {

			cluster0 {

				core0 {
					cpu = <0xa>;
				};

				core1 {
					cpu = <0xb>;
				};

				core2 {
					cpu = <0xc>;
				};

				core3 {
					cpu = <0xd>;
				};
			};
		};

		cpu@0 {
			clock-frequency = <0x77359400>;
			compatible = "arm,cortex-a53";
			cpu-idle-states = <0x3 0x4 0x5 0x6 0x7 0x8 0x9>;
			cpu-release-addr = <0x0 0x40000200>;
			device_type = "cpu";
			enable-method = "psci";
			linux,phandle = <0xa>;
			phandle = <0xa>;
			reg = <0x0>;
		};

		cpu@001 {
			clock-frequency = <0x61a1e580>;
			compatible = "arm,cortex-a53";
			cpu-idle-states = <0x3 0x4 0x5 0x6 0x7 0x8 0x9>;
			cpu-release-addr = <0x0 0x40000200>;
			device_type = "cpu";
			enable-method = "psci";
			linux,phandle = <0xb>;
			phandle = <0xb>;
			reg = <0x1>;
		};

		cpu@002 {
			clock-frequency = <0x61a1e580>;
			compatible = "arm,cortex-a53";
			cpu-idle-states = <0x3 0x4 0x5 0x6 0x7 0x8 0x9>;
			cpu-release-addr = <0x0 0x40000200>;
			device_type = "cpu";
			enable-method = "psci";
			linux,phandle = <0xc>;
			phandle = <0xc>;
			reg = <0x2>;
		};

		cpu@003 {
			clock-frequency = <0x61a1e580>;
			compatible = "arm,cortex-a53";
			cpu-idle-states = <0x3 0x4 0x5 0x6 0x7 0x8 0x9>;
			cpu-release-addr = <0x0 0x40000200>;
			device_type = "cpu";
			enable-method = "psci";
			linux,phandle = <0xd>;
			phandle = <0xd>;
			reg = <0x3>;
		};

		idle-states {
			entry-method = "arm,psci";

			dpidle {
				arm,psci-suspend-param = <0x1010004>;
				compatible = "arm,idle-state";
				entry-latency-us = <0x320>;
				exit-latency-us = <0x3e8>;
				linux,phandle = <0x8>;
				min-residency-us = <0x7d0>;
				phandle = <0x8>;
			};

			mcdi-cluster {
				arm,psci-suspend-param = <0x1010001>;
				compatible = "arm,idle-state";
				entry-latency-us = <0x258>;
				exit-latency-us = <0x258>;
				linux,phandle = <0x5>;
				min-residency-us = <0x4b0>;
				phandle = <0x5>;
			};

			mcdi-cpu {
				arm,psci-suspend-param = <0x10001>;
				compatible = "arm,idle-state";
				entry-latency-us = <0x258>;
				exit-latency-us = <0x258>;
				linux,phandle = <0x4>;
				min-residency-us = <0x4b0>;
				phandle = <0x4>;
			};

			sodi {
				arm,psci-suspend-param = <0x1010002>;
				compatible = "arm,idle-state";
				entry-latency-us = <0x320>;
				exit-latency-us = <0x3e8>;
				linux,phandle = <0x6>;
				min-residency-us = <0x7d0>;
				phandle = <0x6>;
			};

			sodi3 {
				arm,psci-suspend-param = <0x1010003>;
				compatible = "arm,idle-state";
				entry-latency-us = <0x320>;
				exit-latency-us = <0x3e8>;
				linux,phandle = <0x7>;
				min-residency-us = <0x7d0>;
				phandle = <0x7>;
			};

			standby {
				arm,psci-suspend-param = <0x1>;
				compatible = "arm,idle-state";
				entry-latency-us = <0x258>;
				exit-latency-us = <0x258>;
				linux,phandle = <0x3>;
				min-residency-us = <0x4b0>;
				phandle = <0x3>;
			};

			suspend {
				arm,psci-suspend-param = <0x1010005>;
				compatible = "arm,idle-state";
				entry-latency-us = <0x320>;
				exit-latency-us = <0x3e8>;
				linux,phandle = <0x9>;
				min-residency-us = <0x7d0>;
				phandle = <0x9>;
			};
		};
	};

	cq_dma@10212000 {
		clock-names = "cqdma";
		clocks = <0x19 0x44>;
		compatible = "mediatek,mt-cqdma-v1";
		interrupts = <0x0 0x72 0x8>;
		keep_clock_ao = "yes";
		nr_channel = <0x1>;
		reg = <0x0 0x10212080 0x0 0x80>;
	};

	dbg_apmcu_mp0@0d400000 {
		compatible = "mediatek,dbg_apmcu_mp0";
		reg = <0x0 0xd400000 0x0 0x1000>;
	};

	dbg_apmcu_mp0@0d410000 {
		compatible = "mediatek,dbg_apmcu_mp0";
		reg = <0x0 0xd410000 0x0 0x1000>;
	};

	dbg_apmcu_mp0@0d420000 {
		compatible = "mediatek,dbg_apmcu_mp0";
		reg = <0x0 0xd420000 0x0 0x1000>;
	};

	dbg_apmcu_mp0@0d430000 {
		compatible = "mediatek,dbg_apmcu_mp0";
		reg = <0x0 0xd430000 0x0 0x1000>;
	};

	dbg_apmcu_mp0@0d440000 {
		compatible = "mediatek,dbg_apmcu_mp0";
		reg = <0x0 0xd440000 0x0 0x1000>;
	};

	dbg_apmcu_mp0@0d510000 {
		compatible = "mediatek,dbg_apmcu_mp0";
		reg = <0x0 0xd510000 0x0 0x1000>;
	};

	dbg_apmcu_mp0@0d520000 {
		compatible = "mediatek,dbg_apmcu_mp0";
		reg = <0x0 0xd520000 0x0 0x1000>;
	};

	dbg_apmcu_mp0@0d530000 {
		compatible = "mediatek,dbg_apmcu_mp0";
		reg = <0x0 0xd530000 0x0 0x1000>;
	};

	dbg_apmcu_mp0@0d540000 {
		compatible = "mediatek,dbg_apmcu_mp0";
		reg = <0x0 0xd540000 0x0 0x1000>;
	};

	dbg_apmcu_mp0@0d610000 {
		compatible = "mediatek,dbg_apmcu_mp0";
		reg = <0x0 0xd610000 0x0 0x1000>;
	};

	dbg_apmcu_mp0@0d620000 {
		compatible = "mediatek,dbg_apmcu_mp0";
		reg = <0x0 0xd620000 0x0 0x1000>;
	};

	dbg_apmcu_mp0@0d630000 {
		compatible = "mediatek,dbg_apmcu_mp0";
		reg = <0x0 0xd630000 0x0 0x1000>;
	};

	dbg_apmcu_mp0@0d640000 {
		compatible = "mediatek,dbg_apmcu_mp0";
		reg = <0x0 0xd640000 0x0 0x1000>;
	};

	dbg_apmcu_mp0@0d710000 {
		compatible = "mediatek,dbg_apmcu_mp0";
		reg = <0x0 0xd710000 0x0 0x1000>;
	};

	dbg_apmcu_mp0@0d720000 {
		compatible = "mediatek,dbg_apmcu_mp0";
		reg = <0x0 0xd720000 0x0 0x1000>;
	};

	dbg_apmcu_mp0@0d730000 {
		compatible = "mediatek,dbg_apmcu_mp0";
		reg = <0x0 0xd730000 0x0 0x1000>;
	};

	dbg_apmcu_mp0@0d740000 {
		compatible = "mediatek,dbg_apmcu_mp0";
		reg = <0x0 0xd740000 0x0 0x1000>;
	};

	dbg_apmcu_mp1@0d800000 {
		compatible = "mediatek,dbg_apmcu_mp1";
		reg = <0x0 0xd800000 0x0 0x0>;
	};

	dbg_cti@0d020000 {
		compatible = "mediatek,dbg_cti";
		reg = <0x0 0xd020000 0x0 0x10000>;
	};

	dbg_dem@0d0a0000 {
		compatible = "mediatek,dbg_dem";
		interrupts = <0x0 0x8c 0x8>;
		reg = <0x0 0xd0a0000 0x0 0x10000>;
	};

	dbg_etb@0d010000 {
		compatible = "mediatek,dbg_etb";
		reg = <0x0 0xd010000 0x0 0x10000>;
	};

	dbg_etr@0d030000 {
		compatible = "mediatek,dbg_etr";
		reg = <0x0 0xd030000 0x0 0x10000>;
	};

	dbg_funnel@0d040000 {
		compatible = "mediatek,dbg_funnel";
		reg = <0x0 0xd040000 0x0 0x10000>;
	};

	dbg_mdsys1@0d0c0000 {
		compatible = "mediatek,dbg_mdsys1";
		reg = <0x0 0xd0c0000 0x0 0x40000>;
	};

	dbi0@14013000 {
		compatible = "mediatek,dbi0";
		interrupts = <0x0 0xd2 0x8>;
		reg = <0x0 0x14013000 0x0 0x1000>;
	};

	ddrphy@1001e000 {
		compatible = "mediatek,ddrphy";
		reg = <0x0 0x1001e000 0x0 0x1000>;
	};

	devapc@10207000 {
		clock-names = "devapc-infra-clock";
		clocks = <0x19 0x2a>;
		compatible = "mediatek,devapc";
		interrupts = <0x0 0x8e 0x8>;
		reg = <0x0 0x10207000 0x0 0x1000>;
	};

	devinfo {
		compatible = "mediatek,xun_devinfo";
		linux,phandle = <0x3e>;
		phandle = <0x3e>;
	};

	dfd@0c600000 {
		compatible = "mediatek,dfd";
		reg = <0x0 0xc600000 0x0 0x0>;
	};

	disp_aal0@1400f000 {
		aal_support = <0x1>;
		compatible = "mediatek,disp_aal0";
		interrupts = <0x0 0xce 0x8>;
		linux,phandle = <0x53>;
		phandle = <0x53>;
		reg = <0x0 0x1400f000 0x0 0x1000>;
	};

	disp_ccorr0@1400e000 {
		compatible = "mediatek,disp_ccorr0";
		interrupts = <0x0 0xcd 0x8>;
		reg = <0x0 0x1400e000 0x0 0x1000>;
	};

	disp_color0@1400d000 {
		compatible = "mediatek,disp_color0";
		interrupts = <0x0 0xcc 0x8>;
		reg = <0x0 0x1400d000 0x0 0x1000>;
	};

	disp_dither0@14011000 {
		compatible = "mediatek,disp_dither0";
		interrupts = <0x0 0xd0 0x8>;
		reg = <0x0 0x14011000 0x0 0x1000>;
	};

	disp_gamma0@14010000 {
		compatible = "mediatek,disp_gamma0";
		interrupts = <0x0 0xcf 0x8>;
		reg = <0x0 0x14010000 0x0 0x1000>;
	};

	disp_mutex@14001000 {
		compatible = "mediatek,disp_mutex";
		interrupts = <0x0 0xc2 0x8>;
		linux,phandle = <0x22>;
		phandle = <0x22>;
		reg = <0x0 0x14001000 0x0 0x1000>;
	};

	disp_ovl0@1400a000 {
		clock-names = "DISP_OVL0";
		clocks = <0x1b 0xc>;
		compatible = "mediatek,disp_ovl0";
		interrupts = <0x0 0xc9 0x8>;
		linux,phandle = <0x23>;
		phandle = <0x23>;
		reg = <0x0 0x1400a000 0x0 0x1000>;
	};

	disp_pwm0@1100e000 {
		compatible = "mediatek,disp_pwm0";
		reg = <0x0 0x1100e000 0x0 0x1000>;
	};

	disp_rdma0@1400b000 {
		compatible = "mediatek,disp_rdma0";
		interrupts = <0x0 0xca 0x8>;
		reg = <0x0 0x1400b000 0x0 0x1000>;
	};

	disp_wdma0@1400c000 {
		compatible = "mediatek,disp_wdma0";
		interrupts = <0x0 0xcb 0x8>;
		reg = <0x0 0x1400c000 0x0 0x1000>;
	};

	dispsys@14000000 {
		clock-names = "CLK_MM_MTCMOS", "CLK_MM_SMI_COMMON", "CLK_MM_SMI_LARB0", "CLK_MM_GALS_COMM0", "CLK_MM_GALS_COMM1", "CLK_MM_DISP_OVL0", "CLK_MM_DISP_RDMA0", "CLK_MM_DISP_WDMA0", "CLK_MM_DISP_COLOR0", "CLK_MM_DISP_CCORR0", "CLK_MM_DISP_AAL0", "CLK_MM_DISP_GAMMA0", "CLK_MM_DISP_DITHER0", "CLK_MM_DSI_MM_CLOCK", "CLK_MM_DSI_INTERF", "CLK_MM_F26M_HRT", "MDP_WROT0", "DISP_PWM", "MUX_PWM", "CLK26M", "UNIVPLL2_D4", "UNIVPLL2_D8", "UNIVPLL3_D8";
		clocks = <0x1a 0x4 0x1b 0x0 0x1b 0x1 0x1b 0x2 0x1b 0x3 0x1b 0xc 0x1b 0xd 0x1b 0xe 0x1b 0xf 0x1b 0x10 0x1b 0x11 0x1b 0x12 0x1b 0x13 0x1b 0x14 0x1b 0x15 0x1b 0x18 0x1b 0x9 0x19 0x33 0x24 0x39 0x25 0x24 0x19 0x24 0x1a 0x24 0x1f>;
		compatible = "mediatek,dispsys";
		linux,phandle = <0x54>;
		phandle = <0x54>;
	};

	dramc0@1001d000 {
		compatible = "mediatek,dramc0";
		reg = <0x0 0x1001d000 0x0 0x1000>;
	};

	dramc@1001d000 {
		compatible = "mediatek,dramc";
		reg = <0x0 0x1001d000 0x0 0x1000 0x0 0x1021d000 0x0 0x1000 0x0 0x1001e000 0x0 0x1000>;
	};

	dramc_ch0_rsv@1022e000 {
		compatible = "mediatek,dramc_ch0_rsv";
		reg = <0x0 0x1022e000 0x0 0x2000>;
	};

	dramc_ch0_top0@10228000 {
		compatible = "mediatek,dramc_ch0_top0";
		reg = <0x0 0x10228000 0x0 0x2000>;
	};

	dramc_ch0_top1@1022a000 {
		compatible = "mediatek,dramc_ch0_top1";
		reg = <0x0 0x1022a000 0x0 0x2000>;
	};

	dramc_ch0_top2@1022c000 {
		compatible = "mediatek,dramc_ch0_top2";
		reg = <0x0 0x1022c000 0x0 0x1000>;
	};

	dramc_ch0_top3@1022d000 {
		compatible = "mediatek,dramc_ch0_top3";
		reg = <0x0 0x1022d000 0x0 0x1000>;
	};

	dramc_ch1_rsv@10236000 {
		compatible = "mediatek,dramc_ch1_rsv";
		reg = <0x0 0x10236000 0x0 0x2000>;
	};

	dramc_ch1_top0@10230000 {
		compatible = "mediatek,dramc_ch1_top0";
		reg = <0x0 0x10230000 0x0 0x2000>;
	};

	dramc_ch1_top1@10232000 {
		compatible = "mediatek,dramc_ch1_top1";
		reg = <0x0 0x10232000 0x0 0x2000>;
	};

	dramc_ch1_top2@10234000 {
		compatible = "mediatek,dramc_ch1_top2";
		reg = <0x0 0x10234000 0x0 0x1000>;
	};

	dramc_ch1_top3@10235000 {
		compatible = "mediatek,dramc_ch1_top3";
		reg = <0x0 0x10235000 0x0 0x1000>;
	};

	dramc_nao@1021d000 {
		compatible = "mediatek,dramc_nao";
		reg = <0x0 0x1021d000 0x0 0x1000>;
	};

	dsi0@14012000 {
		compatible = "mediatek,dsi0";
		interrupts = <0x0 0xd1 0x8>;
		reg = <0x0 0x14012000 0x0 0x1000>;
	};

	dsi_te {
		compatible = "mediatek, dsi_te-eint";
		linux,phandle = <0x65>;
		phandle = <0x65>;
		status = "disabled";
	};

	dvfsp@10227000 {
		compatible = "mediatek,dvfsp";
		interrupts = <0x0 0xa3 0x8>;
		reg = <0x0 0x10227000 0x0 0x1000>;
	};

	dvfsrc_top@10012000 {
		compatible = "mediatek,dvfsrc_top";
		reg = <0x0 0x10012000 0x0 0x1000>;
	};

	dxcc_sec@10210000 {
		compatible = "mediatek,dxcc_sec";
		interrupts = <0x0 0xa2 0x4>;
		reg = <0x0 0x10210000 0x0 0x1000>;
	};

	eem_fsm@1100b000 {
		clock-names = "CLK_TOP_MFG", "CLK_TOP_MFG_OFF", "CLK_TOP_MFG_ON", "CG_SCP_SYS_MFG0", "CG_SCP_SYS_MFG1";
		clocks = <0x24 0x2d 0x24 0x0 0x24 0x20 0x1a 0x0 0x1a 0x1>;
		compatible = "mediatek,eem_fsm";
		interrupts = <0x0 0x7d 0x8>;
		reg = <0x0 0x1100b000 0x0 0x1000>;
	};

	efuse_dbg@10004000 {
		compatible = "mediatek,efuse_dbg";
		reg = <0x0 0x10004000 0x0 0x1000>;
	};

	efusec@11c00000 {
		compatible = "mediatek,efusec";
		reg = <0x0 0x11c00000 0x0 0x10000>;
	};

	emi@10219000 {
		compatible = "mediatek,emi";
		interrupts = <0x0 0x90 0x8 0x0 0x91 0x4 0x0 0x98 0x4>;
		reg = <0x0 0x10219000 0x0 0x1000 0x0 0x1021a000 0x0 0x1000 0x0 0x10226000 0x0 0x1000>;
	};

	fhctl@1000ce00 {
		compatible = "mediatek,fhctl";
		reg = <0x0 0x1000ce00 0x0 0x100>;
	};

	fingerprint {
		compatible = "mediatek,goodix-fp";
		linux,phandle = <0x5c>;
		phandle = <0x5c>;
	};

	firmware {

		android {
			compatible = "android,firmware";

			fstab {
				compatible = "android,fstab";

				system {
					compatible = "android,system";
					dev = "/dev/block/platform/bootdevice/by-name/system";
					fsmgr_flags = "wait";
					mnt_flags = "ro";
					type = "ext4";
				};

				vendor {
					compatible = "android,vendor";
					dev = "/dev/block/platform/bootdevice/by-name/vendor";
					fsmgr_flags = "wait";
					mnt_flags = "ro";
					type = "ext4";
				};
			};
		};
	};

	flashlight_core {
		compatible = "mediatek,flashlight_core";
		linux,phandle = <0x50>;
		phandle = <0x50>;
	};

	flashlights_rt4505 {
		compatible = "mediatek,flashlights_rt4505";
		linux,phandle = <0x51>;
		phandle = <0x51>;
	};

	gauge_timer {
		compatible = "mediatek,gauge_timer_service";
	};

	gce@10228000 {
		ap_dma_base = <0x18010000 0x17 0xffff0000>;
		audio_base = <0x17000000 0x12 0xffff0000>;
		buf_underrun_event_0 = <0x8c>;
		buf_underrun_event_1 = <0x8d>;
		camsv_1_pass1_done = <0x107>;
		camsv_2_pass1_done = <0x106>;
		camsys1_base = <0x180a0000 0x1c 0xffff0000>;
		camsys2_base = <0x180b0000 0x1d 0xffff0000>;
		camsys_base = <0x18080000 0x1b 0xffff0000>;
		clock-names = "GCE", "GCE_TIMER";
		clocks = <0x19 0x7 0x19 0x18>;
		compatible = "mediatek,gce";
		conn_peri_base = <0x18820000 0x7 0xffff0000>;
		disp_aal0_frame_done = <0x1c>;
		disp_aal0_sof = <0xb>;
		disp_ccorr0_frame_done = <0x1b>;
		disp_ccorr0_sof = <0xa>;
		disp_color0_frame_done = <0x1a>;
		disp_color0_sof = <0x9>;
		disp_dbi0_frame_done = <0x20>;
		disp_dbi0_sof = <0xf>;
		disp_dither0_frame_done = <0x1e>;
		disp_dither0_sof = <0xd>;
		disp_dither_base = <0x14010000 0x2 0xffff0000>;
		disp_dsi0_frame_done = <0x1f>;
		disp_dsi0_sof = <0xe>;
		disp_gamma0_frame_done = <0x1d>;
		disp_gamma0_sof = <0xc>;
		disp_ovl0 = <0x23>;
		disp_ovl0_frame_done = <0x18>;
		disp_ovl0_frame_rst_done_pusle = <0x99>;
		disp_ovl0_sof = <0x6>;
		disp_pwm0_sof = <0x10>;
		disp_rdma0_frame_done = <0x11>;
		disp_rdma0_sof = <0x7>;
		disp_wdma0_frame_done = <0x19>;
		disp_wdma0_rst_done = <0x94>;
		disp_wdma0_sof = <0x8>;
		dsi0_done_event = <0x90>;
		dsi0_irq_event = <0x8f>;
		dsi0_te_event = <0x8e>;
		g3d_config_base = <0x13000000 0x0 0xffff0000>;
		gce_base = <0x18020000 0x18 0xffff0000>;
		gcpu_base = <0x10050000 0xf 0xffff0000>;
		imgsys_base = <0x15020000 0x4 0xffff0000>;
		infra_na3_base = <0x10010000 0xb 0xffff0000>;
		infra_na4_base = <0x10020000 0xc 0xffff0000>;
		interrupts = <0x0 0x9a 0x8 0x0 0x9b 0x8>;
		isp_frame_done_p1_0 = <0x105>;
		isp_frame_done_p1_1 = <0x104>;
		isp_frame_done_p2_0 = <0x103>;
		isp_frame_done_p2_1 = <0x102>;
		isp_frame_done_p2_2 = <0x101>;
		jpgdec_done = <0x123>;
		jpgenc_done = <0x122>;
		kp_base = <0x18840000 0x9 0xffff0000>;
		max_prefetch_cnt = <0x1>;
		mcucfg_base = <0x10040000 0xe 0xffff0000>;
		mdp_rdma0 = <0x1c>;
		mdp_rdma0_frame_done = <0x12>;
		mdp_rdma0_rst_done = <0x98>;
		mdp_rdma0_sof = <0x0>;
		mdp_rsz0 = <0x1d>;
		mdp_rsz0_frame_done = <0x13>;
		mdp_rsz0_sof = <0x1>;
		mdp_rsz1 = <0x1e>;
		mdp_rsz1_frame_done = <0x14>;
		mdp_rsz1_sof = <0x2>;
		mdp_tdshp0 = <0x21>;
		mdp_tdshp_frame_done = <0x15>;
		mdp_tdshp_sof = <0x5>;
		mdp_wdma0 = <0x1f>;
		mdp_wdma_frame_done = <0x17>;
		mdp_wdma_rst_done = <0x95>;
		mdp_wdma_sof = <0x3>;
		mdp_wrot0 = <0x20>;
		mdp_wrot0_rst_done = <0x96>;
		mdp_wrot0_sof = <0x4>;
		mdp_wrot0_write_frame_done = <0x16>;
		mm_mutex = <0x22>;
		mm_na_base = <0x14020000 0x3 0xffff0000>;
		mmsys_config = <0x1b>;
		mmsys_config_base = <0x14000000 0x1 0xffff0000>;
		msdc2_base = <0x17020000 0x14 0xffff0000>;
		msdc3_base = <0x18000000 0x16 0xffff0000>;
		prefetch_size = <0x60>;
		pwm_sw_base = <0x11000000 0x63 0xffff0000>;
		reg = <0x0 0x10228000 0x0 0x4000>;
		scp_base = <0x10030000 0xd 0xffff0000>;
		scp_sram_base = <0x10000000 0xa 0xffff0000>;
		seninf_cam0_fifo_full = <0x109>;
		seninf_cam1_2_3_fifo_full = <0x108>;
		sram_share_cnt = <0x1>;
		sram_share_engine = <0x8>;
		sram_share_event = <0x1e0>;
		sram_size_cpr_64 = <0x40>;
		stream_done_0 = <0x82>;
		stream_done_1 = <0x83>;
		stream_done_2 = <0x84>;
		stream_done_3 = <0x85>;
		stream_done_4 = <0x86>;
		stream_done_5 = <0x87>;
		stream_done_6 = <0x88>;
		stream_done_7 = <0x89>;
		stream_done_8 = <0x8a>;
		stream_done_9 = <0x8b>;
		topckgen_base = <0x18830000 0x8 0xffff0000>;
		usb0_base = <0x10200000 0x10 0xffff0000>;
		usb_sif_base = <0x10280000 0x11 0xffff0000>;
		vdec1_base = <0x17030000 0x15 0xffff0000>;
		vdec2_base = <0x18040000 0x19 0xffff0000>;
		vdec3_base = <0x18050000 0x1a 0xffff0000>;
		vdec_base = <0x17010000 0x13 0xffff0000>;
		vdec_gcon_base = <0x18800000 0x5 0xffff0000>;
		venc_128byte_cnt_done = <0x125>;
		venc_done = <0x121>;
		venc_gcon_base = <0x18810000 0x6 0xffff0000>;
		venc_mb_done = <0x124>;
	};

	gic500@0c000000 {
		compatible = "mediatek,gic500";
		reg = <0x0 0xc000000 0x0 0x0>;
	};

	gic_cpu@0c400000 {
		compatible = "mediatek,gic_cpu";
		reg = <0x0 0xc400000 0x0 0x40000>;
	};

	gpio {
		compatible = "mediatek,gpio_usage_mapping";
		linux,phandle = <0x3b>;
		phandle = <0x3b>;
	};

	gpio@10005000 {
		compatible = "mediatek,gpio";
		linux,phandle = <0x3c>;
		phandle = <0x3c>;
		reg = <0x0 0x10005000 0x0 0x1000>;
	};

	gps {
		compatible = "mediatek,gps";
	};

	gpufreq {
		clock-names = "CLK_TOP_MFG", "CLK_TOP_MFG_OFF", "CLK_TOP_MFG_ON";
		clocks = <0x24 0x2d 0x25 0x24 0x20>;
		compatible = "mediatek,mt6739-gpufreq";
	};

	gse_1 {
		compatible = "mediatek,bma4xy";
		linux,phandle = <0x5e>;
		phandle = <0x5e>;
	};

	gyro {
		compatible = "mediatek,gyroscope";
		linux,phandle = <0x60>;
		phandle = <0x60>;
	};

	hacc@1000a000 {
		compatible = "mediatek,hacc";
		interrupts = <0x0 0xb5 0x8>;
		reg = <0x0 0x1000a000 0x0 0x1000>;
	};

	i2c@11007000 {
		aed = <0x1f>;
		clock-div = <0x5>;
		clock-names = "main", "dma";
		clocks = <0x19 0x9 0x19 0x28>;
		compatible = "mediatek,mt6739-i2c";
		id = <0x0>;
		interrupts = <0x0 0x54 0x8>;
		linux,phandle = <0x43>;
		phandle = <0x43>;
		reg = <0x0 0x11007000 0x0 0x1000 0x0 0x11000100 0x0 0x80>;
	};

	i2c@11008000 {
		aed = <0x1f>;
		clock-div = <0x5>;
		clock-names = "main", "dma";
		clocks = <0x19 0xa 0x19 0x28>;
		compatible = "mediatek,mt6739-i2c";
		id = <0x1>;
		interrupts = <0x0 0x55 0x8>;
		linux,phandle = <0x44>;
		phandle = <0x44>;
		reg = <0x0 0x11008000 0x0 0x1000 0x0 0x11000180 0x0 0x80>;
	};

	i2c@11009000 {
		aed = <0x1f>;
		clock-div = <0x5>;
		clock-names = "main", "dma";
		clocks = <0x19 0xb 0x19 0x28>;
		compatible = "mediatek,mt6739-i2c";
		id = <0x2>;
		interrupts = <0x0 0x56 0x8>;
		linux,phandle = <0x45>;
		phandle = <0x45>;
		reg = <0x0 0x11009000 0x0 0x1000 0x0 0x11000200 0x0 0x80>;
	};

	i2c@1100f000 {
		aed = <0x1f>;
		clock-div = <0x5>;
		clock-names = "main", "dma";
		clocks = <0x19 0xc 0x19 0x28>;
		compatible = "mediatek,mt6739-i2c";
		id = <0x3>;
		interrupts = <0x0 0x57 0x8>;
		linux,phandle = <0x46>;
		phandle = <0x46>;
		reg = <0x0 0x1100f000 0x0 0x1000 0x0 0x11000280 0x0 0x80>;
	};

	i2c@11011000 {
		aed = <0x1f>;
		clock-div = <0x5>;
		clock-names = "main", "dma";
		clocks = <0x19 0x37 0x19 0x28>;
		compatible = "mediatek,mt6739-i2c";
		id = <0x4>;
		interrupts = <0x0 0x58 0x8>;
		linux,phandle = <0x47>;
		phandle = <0x47>;
		reg = <0x0 0x11011000 0x0 0x1000 0x0 0x11000300 0x0 0x80>;
	};

	i2c@11016000 {
		aed = <0x1f>;
		clock-div = <0x5>;
		clock-names = "main", "dma";
		clocks = <0x19 0x3b 0x19 0x28>;
		compatible = "mediatek,mt6739-i2c";
		id = <0x5>;
		interrupts = <0x0 0x82 0x8>;
		linux,phandle = <0x48>;
		phandle = <0x48>;
		reg = <0x0 0x11016000 0x0 0x1000 0x0 0x11000380 0x0 0x80>;
	};

	imgsys_config@15000000 {
		#clock-cells = <0x1>;
		compatible = "mediatek,imgsys", "syscon";
		linux,phandle = <0x36>;
		phandle = <0x36>;
		reg = <0x0 0x15000000 0x0 0x1000>;
	};

	infra_mbist@1020d000 {
		compatible = "mediatek,infra_mbist";
		reg = <0x0 0x1020d000 0x0 0x1000>;
	};

	infracfg@1020e000 {
		compatible = "mediatek,infracfg";
		reg = <0x0 0x1020e000 0x0 0x1000>;
	};

	infracfg_ao@10001000 {
		#clock-cells = <0x1>;
		compatible = "mediatek,infracfg_ao", "syscon";
		interrupts = <0x0 0x93 0x1>;
		linux,phandle = <0x19>;
		phandle = <0x19>;
		reg = <0x0 0x10001000 0x0 0x1000>;
	};

	interrupt-controller@0c000000 {
		#address-cells = <0x2>;
		#interrupt-cells = <0x3>;
		#redistributor-regions = <0x1>;
		#size-cells = <0x2>;
		compatible = "arm,gic-v3";
		interrupt-controller;
		interrupt-parent = <0x2>;
		interrupts = <0x1 0x9 0x4>;
		linux,phandle = <0x2>;
		mediatek,reg_len_pol0 = <0x8>;
		phandle = <0x2>;
		reg = <0x0 0xc000000 0x0 0x40000 0x0 0xc080000 0x0 0x200000 0x0 0x10200620 0x0 0x1000>;
	};

	intpol-controller@0x10200620 {
		#interrupt-cells = <0x3>;
		compatible = "mediatek,mt6739-sysirq", "mediatek,mt6577-sysirq";
		interrupt-controller;
		interrupt-parent = <0x2>;
		linux,phandle = <0x1>;
		phandle = <0x1>;
		reg = <0x0 0x10200620 0x0 0x20>;
	};

	io_cfg_bl@10002600 {
		compatible = "mediatek,io_cfg_bl";
		reg = <0x0 0x10002600 0x0 0x200>;
	};

	io_cfg_bm@10002800 {
		compatible = "mediatek,io_cfg_bm";
		reg = <0x0 0x10002800 0x0 0x200>;
	};

	io_cfg_lb@10002400 {
		compatible = "mediatek,io_cfg_lb";
		reg = <0x0 0x10002400 0x0 0x200>;
	};

	io_cfg_lm@10002200 {
		compatible = "mediatek,io_cfg_lm";
		reg = <0x0 0x10002200 0x0 0x200>;
	};

	io_cfg_lt@10002000 {
		compatible = "mediatek,io_cfg_lt";
		reg = <0x0 0x10002000 0x0 0x200>;
	};

	io_cfg_rb@10002a00 {
		compatible = "mediatek,io_cfg_rb";
		reg = <0x0 0x10002a00 0x0 0x200>;
	};

	io_cfg_rt@10002c00 {
		compatible = "mediatek,io_cfg_rt";
		reg = <0x0 0x10002c00 0x0 0x200>;
	};

	iocfg_0@10002000 {
		compatible = "mediatek,iocfg_0";
		reg = <0x0 0x10002000 0x0 0x200>;
	};

	iocfg_1@10002200 {
		compatible = "mediatek,iocfg_1";
		reg = <0x0 0x10002200 0x0 0x200>;
	};

	iocfg_2@10002400 {
		compatible = "mediatek,iocfg_2";
		reg = <0x0 0x10002400 0x0 0x200>;
	};

	iocfg_3@10002600 {
		compatible = "mediatek,iocfg_3";
		reg = <0x0 0x10002600 0x0 0x200>;
	};

	iocfg_4@10002800 {
		compatible = "mediatek,iocfg_4";
		reg = <0x0 0x10002800 0x0 0x200>;
	};

	iocfg_5@10002a00 {
		compatible = "mediatek,iocfg_5";
		reg = <0x0 0x10002a00 0x0 0x200>;
	};

	irq_nfc {
		compatible = "mediatek,irq_nfc-eint";
		linux,phandle = <0x69>;
		phandle = <0x69>;
	};

	irtx@1100d000 {
		compatible = "mediatek,irtx";
		interrupts = <0x0 0x7f 0x8>;
		reg = <0x0 0x1100d000 0x0 0x1000>;
	};

	irtx_pwm {
		compatible = "mediatek,irtx-pwm";
		linux,phandle = <0x6c>;
		phandle = <0x6c>;
		pwm_ch = <0x1>;
		pwm_data_invert = <0x0>;
	};

	ispsys@15000000 {
		clock-names = "CG_SCP_SYS_MM0", "CG_SCP_SYS_ISP", "CG_IMG_CAM_SMI", "CG_IMG_CAM_CAM", "CG_IMG_SEN_TG", "CG_IMG_SEN_CAM", "CG_IMG_CAM_SV";
		clocks = <0x1a 0x4 0x1a 0x5 0x36 0x1 0x36 0x2 0x36 0x3 0x36 0x4 0x36 0x5>;
		compatible = "mediatek,mt6739-ispsys";
		interrupts = <0x0 0xd9 0x8 0x0 0xda 0x8 0x0 0xdb 0x8 0x0 0xdc 0x8 0x0 0xdd 0x8>;
		reg = <0x0 0x15004000 0x0 0x9000 0x0 0x1500d000 0x0 0x1000 0x0 0x15000000 0x0 0x10000 0x0 0x10215000 0x0 0x3000 0x0 0x10211000 0x0 0x1000>;
	};

	kd_camera_hw1@15008000 {
		clock-names = "CLK_TOP_CAMTG_SEL", "CLK_TOP_CAMTG2_SEL", "CLK_TOP_CLK26M", "CLK_TOP_UNIVPLL_48M_D2", "CLK_TOP_UNIVPLL2_D8", "CLK_TOP_UNIVPLL_D26", "CLK_TOP_UNIVPLL2_D32", "CLK_TOP_UNIVPLL_48M_D4", "CLK_TOP_UNIVPLL_48M_D8", "CLK_TOP_SENINF_SEL", "CLK_TOP_SCAM_SEL";
		clocks = <0x24 0x2e 0x24 0x41 0x25 0x24 0x11 0x24 0x1a 0x24 0x10 0x24 0x1b 0x24 0x12 0x24 0x13 0x24 0x3f 0x24 0x37>;
		compatible = "mediatek,camera_hw";
		linux,phandle = <0x66>;
		phandle = <0x66>;
		reg = <0x0 0x15008000 0x0 0x1000>;
	};

	kp@10010000 {
		compatible = "mediatek,kp";
		interrupts = <0x0 0xb0 0x2>;
		linux,phandle = <0x16>;
		phandle = <0x16>;
		reg = <0x0 0x10010000 0x0 0x1000>;
	};

	m4u@10205000 {
		cell-index = <0x0>;
		compatible = "mediatek,m4u";
		interrupts = <0x0 0x9e 0x8>;
		reg = <0x0 0x10205000 0x0 0x1000>;
	};

	mbist_ao@10013000 {
		compatible = "mediatek,mbist_ao";
		reg = <0x0 0x10013000 0x0 0x1000>;
	};

	mcdi@10216000 {
		compatible = "mediatek,mt6739-mcdi";
		reg = <0x0 0x10fc00 0x0 0x400 0x0 0x10216000 0x0 0x1000 0x0 0x10217000 0x0 0x2000>;
	};

	mcucfg@10200000 {
		compatible = "mediatek,mcucfg";
		interrupts = <0x0 0x0 0x8>;
		reg = <0x0 0x10200000 0x0 0x1000>;
	};

	md1_sim1_hot_plug_eint {
		linux,phandle = <0x6a>;
		phandle = <0x6a>;
	};

	md1_sim2_hot_plug_eint {
		linux,phandle = <0x6b>;
		phandle = <0x6b>;
	};

	md2md_md1_ccif0@10211000 {
		compatible = "mediatek,md2md_md1_ccif0";
		reg = <0x0 0x10211000 0x0 0x1000>;
	};

	md2md_md2_ccif0@10213000 {
		compatible = "mediatek,md2md_md2_ccif0";
		reg = <0x0 0x10213000 0x0 0x1000>;
	};

	md_ccif0@1020a000 {
		compatible = "mediatek,md_ccif0";
		reg = <0x0 0x1020a000 0x0 0x1000>;
	};

	md_ccif1@1020c000 {
		compatible = "mediatek,md_ccif1";
		reg = <0x0 0x1020c000 0x0 0x1000>;
	};

	mdcldma@10014000 {
		clock-names = "scp-sys-md1-main", "infra-cldma-bclk", "infra-ccif-ap", "infra-ccif-md", "infra-ccif1-ap", "infra-ccif1-md";
		clocks = <0x1a 0x2 0x19 0x34 0x19 0x2b 0x19 0x2e 0x19 0x24 0x19 0x25>;
		compatible = "mediatek,mdcldma";
		interrupts = <0x0 0xa5 0x4 0x0 0x94 0x8 0x0 0x95 0x8 0x0 0xe3 0x2>;
		linux,phandle = <0x17>;
		mediatek,cldma_capability = <0x6>;
		mediatek,md_id = <0x0>;
		phandle = <0x17>;
		reg = <0x0 0x10014000 0x0 0x1000 0x0 0x1021b000 0x0 0x1000 0x0 0x10209000 0x0 0x1000 0x0 0x1020a000 0x0 0x1000>;
	};

	mdcldmain@1021c000 {
		compatible = "mediatek,mdcldmain";
		reg = <0x0 0x1021c000 0x0 0x400>;
	};

	mdcldmain_ao@10015000 {
		compatible = "mediatek,mdcldmain_ao";
		reg = <0x0 0x10015000 0x0 0x400>;
	};

	mdcldmamisc@1021c000 {
		compatible = "mediatek,mdcldmamisc";
		reg = <0x0 0x1021c000 0x0 0x0>;
	};

	mdcldmamisc@1021c900 {
		compatible = "mediatek,mdcldmamisc";
		reg = <0x0 0x1021c900 0x0 0x400>;
	};

	mdcldmamisc_ao@10015800 {
		compatible = "mediatek,mdcldmamisc_ao";
		reg = <0x0 0x10015800 0x0 0x400>;
	};

	mdcldmaout@1021c400 {
		compatible = "mediatek,mdcldmaout";
		reg = <0x0 0x1021c400 0x0 0x400>;
	};

	mdcldmaout_ao@10015400 {
		compatible = "mediatek,mdcldmaout_ao";
		reg = <0x0 0x10015400 0x0 0x400>;
	};

	mdp_rdma0@14004000 {
		clock-names = "MDP_RDMA0";
		clocks = <0x1b 0x5>;
		compatible = "mediatek,mdp_rdma0";
		interrupts = <0x0 0xc3 0x8>;
		linux,phandle = <0x1c>;
		phandle = <0x1c>;
		reg = <0x0 0x14004000 0x0 0x1000>;
	};

	mdp_rsz0@14005000 {
		clock-names = "MDP_RSZ0";
		clocks = <0x1b 0x6>;
		compatible = "mediatek,mdp_rsz0";
		interrupts = <0x0 0xc4 0x8>;
		linux,phandle = <0x1d>;
		phandle = <0x1d>;
		reg = <0x0 0x14005000 0x0 0x1000>;
	};

	mdp_rsz1@14006000 {
		clock-names = "MDP_RSZ1";
		clocks = <0x1b 0x7>;
		compatible = "mediatek,mdp_rsz1";
		interrupts = <0x0 0xc5 0x8>;
		linux,phandle = <0x1e>;
		phandle = <0x1e>;
		reg = <0x0 0x14006000 0x0 0x1000>;
	};

	mdp_tdshp0@14009000 {
		clock-names = "MDP_TDSHP";
		clocks = <0x1b 0x8>;
		compatible = "mediatek,mdp_tdshp0";
		linux,phandle = <0x21>;
		phandle = <0x21>;
		reg = <0x0 0x14009000 0x0 0x1000>;
	};

	mdp_wdma0@14007000 {
		clock-names = "MDP_WDMA";
		clocks = <0x1b 0xa>;
		compatible = "mediatek,mdp_wdma0";
		interrupts = <0x0 0xc8 0x8>;
		linux,phandle = <0x1f>;
		phandle = <0x1f>;
		reg = <0x0 0x14007000 0x0 0x1000>;
	};

	mdp_wrot0@14008000 {
		clock-names = "MDP_WROT0";
		clocks = <0x1b 0x9>;
		compatible = "mediatek,mdp_wrot0";
		interrupts = <0x0 0xc7 0x8>;
		linux,phandle = <0x20>;
		phandle = <0x20>;
		reg = <0x0 0x14008000 0x0 0x1000>;
	};

	memory {
		device_type = "memory";
		reg = <0x0 0x40000000 0x0 0x20000000>;
	};

	mfg_auckland@13000000 {
		clock-frequency = <0x21f98280>;
		clock-names = "CLK_TOP_MFG", "CLK_TOP_MFG_OFF", "CLK_TOP_MFG_ON", "CG_SCP_SYS_MFG0", "CG_SCP_SYS_MFG1";
		clocks = <0x24 0x2d 0x25 0x24 0x20 0x1a 0x0 0x1a 0x1>;
		compatible = "mediatek,AUCKLAND";
		interrupt-names = "RGX";
		interrupts = <0x0 0xe2 0x8>;
		reg = <0x0 0x13000000 0x0 0x80000>;
	};

	mfg_cfg@13ffe000 {
		compatible = "mediatek,mt6739-mfg_cfg", "syscon";
		reg = <0x0 0x13ffe000 0x0 0x1000>;
	};

	mipi_rx_ana_csi0@11c10000 {
		compatible = "mediatek,mipi_rx_ana_csi0";
		reg = <0x0 0x11c10000 0x0 0x10000>;
	};

	mipi_rx_ana_csi1@11c20000 {
		compatible = "mediatek,mipi_rx_ana_csi1";
		reg = <0x0 0x11c20000 0x0 0x10000>;
	};

	mipi_tx0@11c80000 {
		compatible = "mediatek,mipi_tx0";
		reg = <0x0 0x11c80000 0x0 0x1000>;
	};

	mm_mutex@14016000 {
		compatible = "mediatek,mm_mutex";
		linux,phandle = <0x55>;
		phandle = <0x55>;
		reg = <0x0 0x14016000 0x0 0x0>;
	};

	mmsys_config@14000000 {
		#clock-cells = <0x1>;
		clock-names = "CAM_MDP";
		clocks = <0x1b 0x4>;
		compatible = "mediatek,mmsys_config", "syscon";
		interrupts = <0x0 0xd3 0x8>;
		linux,phandle = <0x1b>;
		phandle = <0x1b>;
		reg = <0x0 0x14000000 0x0 0x1000>;
	};

	mobicore {
		compatible = "trustonic,mobicore";
		interrupts = <0x0 0x6e 0x1>;
	};

	modem_temp_share@10018000 {
		compatible = "mediatek,modem_temp_share";
		reg = <0x0 0x10018000 0x0 0x1000>;
	};

	mrdump_ext_rst {
		linux,phandle = <0x61>;
		mode = "IRQ";
		phandle = <0x61>;
		source = "EINT";
		status = "okay";
	};

	msdc0_pad_macro@11cd0000 {
		compatible = "mediatek,msdc0_pad_macro";
		reg = <0x0 0x11cd0000 0x0 0x10000>;
	};

	msdc1_ins {
		linux,phandle = <0x62>;
		phandle = <0x62>;
	};

	msdc1_pad_macro@11c40000 {
		compatible = "mediatek,msdc1_pad_macro";
		reg = <0x0 0x11c40000 0x0 0x10000>;
	};

	msdc@11230000 {
		bus-width = <0x8>;
		cap-mmc-highspeed;
		clk_src = [01];
		clock-names = "msdc0-clock", "msdc0-hclock";
		clocks = <0x19 0x4b 0x19 0x1c>;
		compatible = "mediatek,msdc";
		host_function = [00];
		hw_dvfs = [00];
		index = [00];
		interrupts = <0x0 0x4f 0x8>;
		linux,phandle = <0x4c>;
		max-frequency = <0xbebc200>;
		mmc-ddr-1_8v;
		mmc-hs200-1_8v;
		mmc-hs400-1_8v;
		msdc-sys-suspend;
		non-removable;
		phandle = <0x4c>;
		pinctl = <0x26>;
		reg = <0x0 0x11230000 0x0 0x10000 0x0 0x11cd0000 0x0 0x10000>;
		register_setting = <0x27>;
		status = "okay";
		vmmc-supply = <0x28>;

		msdc0@default {
			linux,phandle = <0x26>;
			phandle = <0x26>;

			pins_clk {
				drive-strength = [04];
			};

			pins_cmd {
				drive-strength = [04];
			};

			pins_dat {
				drive-strength = [04];
			};

			pins_ds {
				drive-strength = [04];
			};

			pins_rst {
				drive-strength = [04];
			};
		};

		msdc0@register_default {
			cmd_edge = [00];
			linux,phandle = <0x27>;
			phandle = <0x27>;
			rdata_edge = [00];
			wdata_edge = [00];
		};
	};

	msdc@11240000 {
		bus-width = <0x4>;
		cap-sd-highspeed;
		cd-gpios = <0x2e 0xf 0x0>;
		cd_level = [00];
		clk_src = [02];
		clock-names = "msdc1-clock", "msdc1-hclock";
		clocks = <0x19 0x4c 0x19 0x1d>;
		compatible = "mediatek,msdc";
		host_function = [01];
		hw_dvfs = [00];
		index = [01];
		interrupts = <0x0 0x50 0x8>;
		linux,phandle = <0x4d>;
		max-frequency = <0xbebc200>;
		msdc-sys-suspend;
		phandle = <0x4d>;
		pinctl = <0x29>;
		pinctl_ddr50 = <0x2c>;
		pinctl_sdr104 = <0x2a>;
		pinctl_sdr50 = <0x2b>;
		reg = <0x0 0x11240000 0x0 0x10000 0x0 0x11c40000 0x0 0x10000>;
		register_setting = <0x2d>;
		sd-uhs-ddr50;
		sd-uhs-sdr104;
		sd-uhs-sdr12;
		sd-uhs-sdr25;
		sd-uhs-sdr50;
		status = "okay";
		vmmc-supply = <0x2f>;
		vqmmc-supply = <0x30>;

		msdc1@ddr50 {
			linux,phandle = <0x2c>;
			phandle = <0x2c>;

			pins_clk {
				drive-strength = [03];
			};

			pins_cmd {
				drive-strength = [03];
			};

			pins_dat {
				drive-strength = [03];
			};
		};

		msdc1@default {
			linux,phandle = <0x29>;
			phandle = <0x29>;

			pins_clk {
				drive-strength = [03];
			};

			pins_cmd {
				drive-strength = [03];
			};

			pins_dat {
				drive-strength = [03];
			};
		};

		msdc1@register_default {
			cmd_edge = [00];
			linux,phandle = <0x2d>;
			phandle = <0x2d>;
			rdata_edge = [00];
			wdata_edge = [00];
		};

		msdc1@sdr104 {
			linux,phandle = <0x2a>;
			phandle = <0x2a>;

			pins_clk {
				drive-strength = [03];
			};

			pins_cmd {
				drive-strength = [03];
			};

			pins_dat {
				drive-strength = [03];
			};
		};

		msdc1@sdr50 {
			linux,phandle = <0x2b>;
			phandle = <0x2b>;

			pins_clk {
				drive-strength = [03];
			};

			pins_cmd {
				drive-strength = [03];
			};

			pins_dat {
				drive-strength = [03];
			};
		};
	};

	mse {
		linux,phandle = <0x5f>;
		phandle = <0x5f>;
	};

	mt6357_gauge {
		alias_name = "mt6357";
		compatible = "mediatek,mt6357_gauge";
		gauge_name = "gauge";
	};

	mt_charger {
		compatible = "mediatek,mt-charger";
		linux,phandle = <0x58>;
		phandle = <0x58>;
	};

	mt_pmic_regulator {
		compatible = "mediatek,mt_pmic";

		buck_regulators {
			compatible = "mediatek,mt_pmic_buck_regulators";

			buck_vcore {
				linux,phandle = <0x70>;
				phandle = <0x70>;
				regulator-enable-ramp-delay = <0xdc>;
				regulator-max-microvolt = <0x123716>;
				regulator-min-microvolt = <0x7ea5e>;
				regulator-name = "vcore";
				regulator-ramp-delay = <0x186a>;
			};

			buck_vmodem {
				linux,phandle = <0x6f>;
				phandle = <0x6f>;
				regulator-enable-ramp-delay = <0xdc>;
				regulator-max-microvolt = <0x123716>;
				regulator-min-microvolt = <0x7a120>;
				regulator-name = "vmodem";
				regulator-ramp-delay = <0x186a>;
			};

			buck_vpa {
				linux,phandle = <0x72>;
				phandle = <0x72>;
				regulator-enable-ramp-delay = <0xdc>;
				regulator-max-microvolt = <0x37b1d0>;
				regulator-min-microvolt = <0x7a120>;
				regulator-name = "vpa";
				regulator-ramp-delay = <0xc350>;
			};

			buck_vproc {
				linux,phandle = <0x71>;
				phandle = <0x71>;
				regulator-enable-ramp-delay = <0xdc>;
				regulator-max-microvolt = <0x1406f4>;
				regulator-min-microvolt = <0x7ea5e>;
				regulator-name = "vproc";
				regulator-ramp-delay = <0x186a>;
			};

			buck_vs1 {
				linux,phandle = <0x6e>;
				phandle = <0x6e>;
				regulator-enable-ramp-delay = <0xdc>;
				regulator-max-microvolt = <0x2191c0>;
				regulator-min-microvolt = <0x124f80>;
				regulator-name = "vs1";
				regulator-ramp-delay = <0x30d4>;
			};
		};

		ldo_regulators {
			compatible = "mediatek,mt_pmic_ldo_regulators";

			ldo_vaud28 {
				compatible = "regulator-fixed";
				linux,phandle = <0x83>;
				phandle = <0x83>;
				regulator-enable-ramp-delay = <0x108>;
				regulator-max-microvolt = <0x2ab980>;
				regulator-min-microvolt = <0x2ab980>;
				regulator-name = "vaud28";
			};

			ldo_vaux18 {
				compatible = "regulator-fixed";
				linux,phandle = <0x82>;
				phandle = <0x82>;
				regulator-enable-ramp-delay = <0x108>;
				regulator-max-microvolt = <0x1b7740>;
				regulator-min-microvolt = <0x1b7740>;
				regulator-name = "vaux18";
			};

			ldo_vcama {
				linux,phandle = <0x7c>;
				phandle = <0x7c>;
				regulator-enable-ramp-delay = <0x108>;
				regulator-max-microvolt = <0x2ab980>;
				regulator-min-microvolt = <0x2625a0>;
				regulator-name = "vcama";
			};

			ldo_vcamd {
				linux,phandle = <0x7d>;
				phandle = <0x7d>;
				regulator-enable-ramp-delay = <0x108>;
				regulator-max-microvolt = <0x1b7740>;
				regulator-min-microvolt = <0xf4240>;
				regulator-name = "vcamd";
			};

			ldo_vcamio {
				compatible = "regulator-fixed";
				linux,phandle = <0x7e>;
				phandle = <0x7e>;
				regulator-enable-ramp-delay = <0x108>;
				regulator-max-microvolt = <0x1b7740>;
				regulator-min-microvolt = <0x1b7740>;
				regulator-name = "vcamio";
			};

			ldo_vcn18 {
				compatible = "regulator-fixed";
				linux,phandle = <0x7b>;
				phandle = <0x7b>;
				regulator-enable-ramp-delay = <0x108>;
				regulator-max-microvolt = <0x1b7740>;
				regulator-min-microvolt = <0x1b7740>;
				regulator-name = "vcn18";
			};

			ldo_vcn28 {
				compatible = "regulator-fixed";
				linux,phandle = <0x7a>;
				phandle = <0x7a>;
				regulator-enable-ramp-delay = <0x108>;
				regulator-max-microvolt = <0x2ab980>;
				regulator-min-microvolt = <0x2ab980>;
				regulator-name = "vcn28";
			};

			ldo_vcn33_bt {
				linux,phandle = <0x78>;
				phandle = <0x78>;
				regulator-enable-ramp-delay = <0x108>;
				regulator-max-microvolt = <0x3567e0>;
				regulator-min-microvolt = <0x325aa0>;
				regulator-name = "vcn33_bt";
			};

			ldo_vcn33_wifi {
				linux,phandle = <0x79>;
				phandle = <0x79>;
				regulator-enable-ramp-delay = <0x108>;
				regulator-max-microvolt = <0x3567e0>;
				regulator-min-microvolt = <0x325aa0>;
				regulator-name = "vcn33_wifi";
			};

			ldo_vdram {
				linux,phandle = <0x86>;
				phandle = <0x86>;
				regulator-enable-ramp-delay = <0xce4>;
				regulator-max-microvolt = <0x124f80>;
				regulator-min-microvolt = <0x10c8e0>;
				regulator-name = "vdram";
			};

			ldo_vefuse {
				linux,phandle = <0x77>;
				phandle = <0x77>;
				regulator-enable-ramp-delay = <0x108>;
				regulator-max-microvolt = <0x325aa0>;
				regulator-min-microvolt = <0x124f80>;
				regulator-name = "vefuse";
			};

			ldo_vemc {
				linux,phandle = <0x28>;
				phandle = <0x28>;
				regulator-enable-ramp-delay = <0x2c>;
				regulator-max-microvolt = <0x325aa0>;
				regulator-min-microvolt = <0x2c4020>;
				regulator-name = "vemc";
			};

			ldo_vfe28 {
				compatible = "regulator-fixed";
				linux,phandle = <0x73>;
				phandle = <0x73>;
				regulator-enable-ramp-delay = <0x108>;
				regulator-max-microvolt = <0x2ab980>;
				regulator-min-microvolt = <0x2ab980>;
				regulator-name = "vfe28";
			};

			ldo_vibr {
				linux,phandle = <0x89>;
				phandle = <0x89>;
				regulator-enable-ramp-delay = <0x2c>;
				regulator-max-microvolt = <0x325aa0>;
				regulator-min-microvolt = <0x124f80>;
				regulator-name = "vibr";
			};

			ldo_vio18 {
				compatible = "regulator-fixed";
				linux,phandle = <0x85>;
				phandle = <0x85>;
				regulator-enable-ramp-delay = <0x108>;
				regulator-max-microvolt = <0x1b7740>;
				regulator-min-microvolt = <0x1b7740>;
				regulator-name = "vio18";
			};

			ldo_vio28 {
				compatible = "regulator-fixed";
				linux,phandle = <0x84>;
				phandle = <0x84>;
				regulator-enable-ramp-delay = <0x108>;
				regulator-max-microvolt = <0x2ab980>;
				regulator-min-microvolt = <0x2ab980>;
				regulator-name = "vio28";
			};

			ldo_vldo28 {
				linux,phandle = <0x7f>;
				phandle = <0x7f>;
				regulator-enable-ramp-delay = <0x108>;
				regulator-max-microvolt = <0x2dc6c0>;
				regulator-min-microvolt = <0x2ab980>;
				regulator-name = "vldo28";
			};

			ldo_vmc {
				linux,phandle = <0x30>;
				phandle = <0x30>;
				regulator-enable-ramp-delay = <0x2c>;
				regulator-max-microvolt = <0x325aa0>;
				regulator-min-microvolt = <0x1b7740>;
				regulator-name = "vmc";
			};

			ldo_vmch {
				linux,phandle = <0x2f>;
				phandle = <0x2f>;
				regulator-enable-ramp-delay = <0x2c>;
				regulator-max-microvolt = <0x325aa0>;
				regulator-min-microvolt = <0x2c4020>;
				regulator-name = "vmch";
			};

			ldo_vrf12 {
				compatible = "regulator-fixed";
				linux,phandle = <0x76>;
				phandle = <0x76>;
				regulator-enable-ramp-delay = <0x6e>;
				regulator-max-microvolt = <0x124f80>;
				regulator-min-microvolt = <0x124f80>;
				regulator-name = "vrf12";
			};

			ldo_vrf18 {
				compatible = "regulator-fixed";
				linux,phandle = <0x75>;
				phandle = <0x75>;
				regulator-enable-ramp-delay = <0x6e>;
				regulator-max-microvolt = <0x1b7740>;
				regulator-min-microvolt = <0x1b7740>;
				regulator-name = "vrf18";
			};

			ldo_vsim1 {
				linux,phandle = <0x87>;
				phandle = <0x87>;
				regulator-enable-ramp-delay = <0x108>;
				regulator-max-microvolt = <0x2f4d60>;
				regulator-min-microvolt = <0x19f0a0>;
				regulator-name = "vsim1";
			};

			ldo_vsim2 {
				linux,phandle = <0x88>;
				phandle = <0x88>;
				regulator-enable-ramp-delay = <0x108>;
				regulator-max-microvolt = <0x2f4d60>;
				regulator-min-microvolt = <0x19f0a0>;
				regulator-name = "vsim2";
			};

			ldo_vsram_others {
				linux,phandle = <0x80>;
				phandle = <0x80>;
				regulator-enable-ramp-delay = <0x6e>;
				regulator-max-microvolt = <0x1406f4>;
				regulator-min-microvolt = <0x7ea5e>;
				regulator-name = "vsram_others";
				regulator-ramp-delay = <0x186a>;
			};

			ldo_vsram_proc {
				linux,phandle = <0x81>;
				phandle = <0x81>;
				regulator-enable-ramp-delay = <0x6e>;
				regulator-max-microvolt = <0x1406f4>;
				regulator-min-microvolt = <0x7ea5e>;
				regulator-name = "vsram_proc";
				regulator-ramp-delay = <0x186a>;
			};

			ldo_vusb33 {
				linux,phandle = <0x8a>;
				phandle = <0x8a>;
				regulator-enable-ramp-delay = <0x108>;
				regulator-max-microvolt = <0x2f4d60>;
				regulator-min-microvolt = <0x2dc6c0>;
				regulator-name = "vusb33";
			};

			ldo_vxo22 {
				linux,phandle = <0x74>;
				phandle = <0x74>;
				regulator-enable-ramp-delay = <0x6e>;
				regulator-max-microvolt = <0x249f00>;
				regulator-min-microvolt = <0x2191c0>;
				regulator-name = "vxo22";
			};
		};
	};

	mt_soc_anc_pcm {
		compatible = "mediatek,mt_soc_pcm_anc";
	};

	mt_soc_btcvsd_rx_pcm {
		compatible = "mediatek,mt_soc_btcvsd_rx_pcm";
	};

	mt_soc_btcvsd_tx_pcm {
		compatible = "mediatek,mt_soc_btcvsd_tx_pcm";
	};

	mt_soc_codec_dummy_name {
		compatible = "mediatek,mt_soc_codec_dummy";
	};

	mt_soc_codec_name {
		compatible = "mediatek,mt_soc_codec_63xx";
		use_hp_depop_flow = <0x0>;
		use_ul_260k = <0x0>;
	};

	mt_soc_dai_name {
		compatible = "mediatek,mt_soc_dai_stub";
	};

	mt_soc_deep_buffer_dl_pcm {
		compatible = "mediatek,mt_soc_pcm_deep_buffer_dl";
	};

	mt_soc_dl1_awb_pcm {
		compatible = "mediatek,mt_soc_pcm_dl1_awb";
	};

	mt_soc_dl1_pcm@11220000 {
		clock-names = "aud_afe_clk", "aud_dac_clk", "aud_dac_predis_clk", "aud_adc_clk", "aud_apll22m_clk", "aud_apll1_tuner_clk", "aud_tml_clk", "aud_infra_clk", "mtkaif_26m_clk", "top_mux_audio", "top_mux_audio_int", "top_sys_pll1_d4", "top_mux_aud_1", "top_apll1_ck", "top_mux_aud_eng1", "top_apll1_d8", "apmixed_apll1", "top_clk26m_clk";
		clocks = <0x31 0x0 0x31 0x4 0x31 0x5 0x31 0x3 0x31 0x1 0x31 0x2 0x31 0x6 0x19 0x2d 0x19 0x35 0x24 0x34 0x24 0x35 0x24 0x3 0x24 0x38 0x24 0x24 0x24 0x42 0x24 0x27 0x32 0x6 0x25>;
		compatible = "mediatek,mt_soc_pcm_dl1";
		interrupts = <0x0 0x99 0x8>;
		linux,phandle = <0x4e>;
		phandle = <0x4e>;
		reg = <0x0 0x11220000 0x0 0x1000>;
	};

	mt_soc_dl2_pcm {
		compatible = "mediatek,mt_soc_pcm_dl2";
	};

	mt_soc_dummy_pcm {
		compatible = "mediatek,mt_soc_pcm_dummy";
	};

	mt_soc_fm_i2s_awb_pcm {
		compatible = "mediatek,mt_soc_pcm_fm_i2s_awb";
	};

	mt_soc_fm_i2s_pcm {
		compatible = "mediatek,mt_soc_pcm_fm_i2s";
	};

	mt_soc_fm_mrgtx_pcm {
		compatible = "mediatek,mt_soc_pcm_fmtx";
	};

	mt_soc_hdmi_pcm {
		compatible = "mediatek,mt_soc_pcm_hdmi";
	};

	mt_soc_hp_impedance_pcm {
		compatible = "mediatek,mt_soc_pcm_hp_impedance";
	};

	mt_soc_i2s0_awb_pcm {
		compatible = "mediatek,mt_soc_pcm_i2s0_awb";
	};

	mt_soc_i2s0_pcm {
		compatible = "mediatek,mt_soc_pcm_dl1_i2s0";
	};

	mt_soc_i2s0dl1_pcm {
		compatible = "mediatek,mt_soc_pcm_dl1_i2s0dl1";
	};

	mt_soc_mrgrx_awb_pcm {
		compatible = "mediatek,mt_soc_pcm_mrgrx_awb";
	};

	mt_soc_mrgrx_pcm {
		compatible = "mediatek,mt_soc_pcm_mrgrx";
	};

	mt_soc_pcm_voice_ultra {
		compatible = "mediatek,mt_soc_pcm_voice_ultra";
	};

	mt_soc_pcm_voice_usb {
		compatible = "mediatek,mt_soc_pcm_voice_usb";
	};

	mt_soc_pcm_voice_usb_echoref {
		compatible = "mediatek,mt_soc_pcm_voice_usb_echoref";
	};

	mt_soc_routing_dai_name {
		compatible = "mediatek,mt_soc_dai_routing";
	};

	mt_soc_routing_pcm {
		compatible = "mediatek,mt_soc_pcm_routing";
	};

	mt_soc_tdmrx_pcm {
		compatible = "mediatek,mt_soc_tdm_capture";
	};

	mt_soc_ul1_pcm {
		compatible = "mediatek,mt_soc_pcm_capture";
	};

	mt_soc_ul2_pcm {
		compatible = "mediatek,mt_soc_pcm_capture2";
	};

	mt_soc_uldlloopback_pcm {
		compatible = "mediatek,mt_soc_pcm_uldlloopback";
	};

	mt_soc_voice_md1 {
		compatible = "mediatek,mt_soc_pcm_voice_md1";
	};

	mt_soc_voice_md1_bt {
		compatible = "mediatek,mt_soc_pcm_voice_md1_bt";
	};

	mt_soc_voice_md2 {
		compatible = "mediatek,mt_soc_pcm_voice_md2";
	};

	mt_soc_voice_md2_bt {
		compatible = "mediatek,mt_soc_pcm_voice_md2_bt";
	};

	mt_soc_voip_bt_in {
		compatible = "mediatek,mt_soc_pcm_bt_dai";
	};

	mt_soc_voip_bt_out {
		compatible = "mediatek,mt_soc_pcm_dl1_bt";
	};

	mtkfb {
		compatible = "mediatek,mtkfb";
		linux,phandle = <0x52>;
		phandle = <0x52>;
	};

	nfc {
		compatible = "mediatek,nfc-gpio-v2";
		gpio-irq = <0xe>;
		gpio-irq-std = <0x2e 0xe 0x0>;
		gpio-rst = <0x7>;
		gpio-rst-std = <0x2e 0x7 0x0>;
		linux,phandle = <0x68>;
		phandle = <0x68>;
	};

	nfi@11018000 {
		clock-names = "nfi2x_sel", "nfiecc_sel", "clk26m", "syspll2_d2", "syspll_d7", "syspll_d3", "syspll2_d4", "msdcpll_d2", "univpll1_d2", "univpll_d5", "syspll4_d2", "univpll2_d4", "syspll1_d2", "univpll2_d2", "syspll_d5", "infra_nfiecc", "infra_nfi", "infra_nfi_1x";
		clocks = <0x24 0x3a 0x24 0x3b 0x25 0x24 0x7 0x24 0xc 0x24 0x6 0x24 0x8 0x24 0x23 0x24 0x15 0x24 0x1c 0x24 0xd 0x24 0x19 0x24 0x2 0x24 0x18 0x24 0x9 0x19 0x1e 0x19 0x27 0x19 0x4f>;
		compatible = "mediatek,nfi";
		interrupts = <0x0 0x86 0x8>;
		reg = <0x0 0x11018000 0x0 0x1000>;
	};

	nfiecc@11019000 {
		compatible = "mediatek,nfiecc";
		interrupts = <0x0 0x87 0x8>;
		reg = <0x0 0x11019000 0x0 0x1000>;
	};

	odm {
		compatible = "simple-bus";
		linux,phandle = <0x6d>;
		phandle = <0x6d>;
	};

	otg_iddig {
		compatible = "mediatek,usb_iddig_bi_eint";
		linux,phandle = <0x67>;
		phandle = <0x67>;
	};

	pericfg@10003000 {
		compatible = "mediatek,pericfg";
		reg = <0x0 0x10003000 0x0 0x1000>;
	};

	pinctrl@1000b000 {
		#gpio-cells = <0x2>;
		#interrupt-cells = <0x4>;
		compatible = "mediatek,pinctrl";
		gpio-controller;
		interrupt-controller;
		interrupts = <0x0 0xa7 0x4>;
		linux,phandle = <0x2e>;
		mediatek,pctl-regmap = <0xe 0xf 0x10 0x11 0x12 0x13 0x14 0x15>;
		phandle = <0x2e>;
		pins-are-numbered;
		reg = <0x0 0x1000b000 0x0 0x1000>;
	};

	pmic_clock_buffer_ctrl {
		compatible = "mediatek,pmic_clock_buffer";
		linux,phandle = <0x5a>;
		mediatek,clkbuf-config = <0x2 0x1 0x1 0x2 0x0 0x0 0x0>;
		mediatek,clkbuf-driving-current = <0xffffffff 0xffffffff 0xffffffff 0xffffffff 0xffffffff 0xffffffff 0xffffffff>;
		mediatek,clkbuf-quantity = <0x7>;
		phandle = <0x5a>;
	};

	pmu {
		compatible = "arm,cortex-a7-pmu";
		interrupt-parent = <0x2>;
		interrupts = <0x1 0x7 0x8>;
	};

	psci {
		compatible = "arm,psci-0.2";
		method = "smc";
	};

	pwm@11006000 {
		clock-names = "PWM1-main", "PWM2-main", "PWM3-main", "PWM4-main", "PWM5-main", "PWM6-main", "PWM-HCLK-main", "PWM-main";
		clocks = <0x19 0xe 0x19 0xf 0x19 0x10 0x19 0x11 0x19 0x12 0x19 0x32 0x19 0xd 0x19 0x13>;
		compatible = "mediatek,pwm";
		interrupts = <0x0 0x4d 0x8>;
		reg = <0x0 0x11006000 0x0 0x1000>;
	};

	pwrap@1000d000 {
		compatible = "mediatek,pwrap";
		interrupts = <0x0 0xaf 0x4>;
		reg = <0x0 0x1000d000 0x0 0x1000>;

		pmic_irq {
			compatible = "mediatek,pmic-eint";
			interrupt-controller;
			linux,phandle = <0x3f>;
			phandle = <0x3f>;
		};
	};

	reserved-memory {
		#address-cells = <0x2>;
		#size-cells = <0x2>;
		linux,phandle = <0x3a>;
		phandle = <0x3a>;
		ranges;

		consys-reserve-memory {
			#address-cells = <0x2>;
			#size-cells = <0x2>;
			alignment = <0x0 0x200000>;
			alloc-ranges = <0x0 0x40000000 0x0 0x38000000>;
			compatible = "mediatek,consys-reserve-memory";
			no-map;
			size = <0x0 0x200000>;
		};

		minirdump-reserved-memory@444f0000 {
			compatible = "mediatek,minirdump";
			reg = <0x0 0x444f0000 0x0 0x10000>;
		};

		pstore-reserved-memory@44410000 {
			compatible = "mediatek,pstore";
			reg = <0x0 0x44410000 0x0 0xe0000>;
		};

		ram_console-reserved-memory@44400000 {
			compatible = "mediatek,ram_console";
			reg = <0x0 0x44400000 0x0 0x10000>;
		};
	};

	rt9465_slave_chr {
		linux,phandle = <0x64>;
		phandle = <0x64>;
	};

	scpsys@10001000 {
		#clock-cells = <0x1>;
		compatible = "mediatek,scpsys";
		linux,phandle = <0x1a>;
		phandle = <0x1a>;
		reg = <0x0 0x10001000 0x0 0x1000 0x0 0x10006000 0x0 0x1000 0x0 0x1020e000 0x0 0x1000>;
	};

	security_ao@1001a000 {
		compatible = "mediatek,security_ao";
		reg = <0x0 0x1001a000 0x0 0x1000>;
	};

	seninf@15008000 {
		compatible = "mediatek,seninf";
		reg = <0x0 0x15008000 0x0 0x1000>;
	};

	sleep@10006000 {
		compatible = "mediatek,sleep";
		interrupts = <0x0 0xb1 0x8>;
		reg = <0x0 0x10006000 0x0 0x1000>;
		wakeup-source = <0x16 0x0 0x4 0x17 0x3 0x2000000>;
	};

	sleep_reg_md@1000f000 {
		compatible = "mediatek,sleep_reg_md";
		reg = <0x0 0x1000f000 0x0 0x1000>;
	};

	smi_common@14002000 {
		clock-names = "mtcmos-mm", "smi-common-gals0", "smi-common-gals1", "smi-common", "MMDVFS_CLK_TOP_MMPLL_CK", "mmdvfs_clk_top_vencpll_ck", "mmdvfs_clk_top_syspll2_d2";
		clocks = <0x1a 0x4 0x1b 0x2 0x1b 0x3 0x1b 0x0 0x24 0x2c 0x24 0x21 0x24 0x7>;
		compatible = "mediatek,smi_common";
		larbs = <0x33 0x34 0x35>;
		reg = <0x0 0x14002000 0x0 0x1000>;
	};

	smi_larb0@14003000 {
		clock-names = "mtcmos-mm", "mm-larb0";
		clocks = <0x1a 0x4 0x1b 0x1>;
		compatible = "mediatek,smi_larb0";
		interrupts = <0x0 0xdf 0x8>;
		linux,phandle = <0x33>;
		phandle = <0x33>;
		reg = <0x0 0x14003000 0x0 0x1000>;
	};

	smi_larb1@17010000 {
		clock-names = "mtcmos-ven", "venc-larb", "venc-venc";
		clocks = <0x1a 0x6 0x37 0x0 0x37 0x1>;
		compatible = "mediatek,smi_larb1";
		interrupts = <0x0 0xd5 0x8>;
		linux,phandle = <0x34>;
		phandle = <0x34>;
		reg = <0x0 0x17010000 0x0 0x1000>;
	};

	smi_larb2@15001000 {
		clock-names = "mtcmos-img", "img-larb2";
		clocks = <0x1a 0x5 0x36 0x0>;
		compatible = "mediatek,smi_larb2";
		interrupts = <0x0 0xde 0x8>;
		linux,phandle = <0x35>;
		phandle = <0x35>;
		reg = <0x0 0x15001000 0x0 0x1000>;
	};

	smi_larb3@17010000 {
		compatible = "mediatek,smi_larb3";
		interrupts = <0x0 0xe7 0x8>;
		reg = <0x0 0x17010000 0x0 0x1000>;
	};

	spi2@11010000 {
		compatible = "mediatek,spi2";
		interrupts = <0x0 0x80 0x8>;
		reg = <0x0 0x11010000 0x0 0x1000>;
	};

	spi3@11012000 {
		compatible = "mediatek,spi3";
		interrupts = <0x0 0x81 0x8>;
		reg = <0x0 0x11012000 0x0 0x0>;
	};

	spi4@11013000 {
		compatible = "mediatek,spi4";
		reg = <0x0 0x11013000 0x0 0x1000>;
	};

	spi@1100a000 {
		clock-names = "parent-clk", "sel-clk", "spi-clk";
		clocks = <0x24 0xa 0x24 0x30 0x19 0x1b>;
		compatible = "mediatek,mt6739-spi";
		interrupts = <0x0 0x76 0x8>;
		linux,phandle = <0x49>;
		mediatek,pad-select = <0x0>;
		phandle = <0x49>;
		reg = <0x0 0x1100a000 0x0 0x1000>;
	};

	spi@11010000 {
		clock-names = "parent-clk", "sel-clk", "spi-clk";
		clocks = <0x24 0xa 0x24 0x30 0x19 0x36>;
		compatible = "mediatek,mt6739-spi";
		interrupts = <0x0 0x7a 0x8>;
		linux,phandle = <0x4a>;
		mediatek,pad-select = <0x0>;
		phandle = <0x4a>;
		reg = <0x0 0x11010000 0x0 0x1000>;
	};

	spi@11012000 {
		clock-names = "parent-clk", "sel-clk", "spi-clk";
		clocks = <0x24 0xa 0x24 0x30 0x19 0x39>;
		compatible = "mediatek,mt6739-spi";
		interrupts = <0x0 0x80 0x8>;
		linux,phandle = <0x4b>;
		mediatek,pad-select = <0x0>;
		phandle = <0x4b>;
		reg = <0x0 0x11012000 0x0 0x1000>;
	};

	sramrom@10214000 {
		compatible = "mediatek,sramrom";
		reg = <0x0 0x10214000 0x0 0x1000>;
	};

	sys_cirq@10204000 {
		compatible = "mediatek,sys_cirq";
		interrupts = <0x0 0xf0 0x8>;
		mediatek,cirq_num = <0xa8>;
		mediatek,spi_start_offset = <0x48>;
		reg = <0x0 0x10204000 0x0 0x1000>;
	};

	sys_timer@10017000 {
		compatible = "mediatek,sys_timer";
		interrupts = <0x0 0xba 0x4>;
		mediatek,sysram-size = <0x14>;
		reg = <0x0 0x10017000 0x0 0x1000 0x0 0x10ffec 0x0 0x14>;
	};

	syscfg_pctl_a@10005000 {
		compatible = "mediatek,pctl-a-syscfg", "syscon";
		linux,phandle = <0xe>;
		phandle = <0xe>;
		reg = <0x0 0x10005000 0x0 0x1000>;
	};

	syscfg_pctl_bl@10002600 {
		compatible = "mediatek,pctl-bl-syscfg", "syscon";
		linux,phandle = <0x12>;
		phandle = <0x12>;
		reg = <0x0 0x10002600 0x0 0x1000>;
	};

	syscfg_pctl_bl@10002c00 {
		compatible = "mediatek,pctl-rt-syscfg", "syscon";
		linux,phandle = <0x15>;
		phandle = <0x15>;
		reg = <0x0 0x10002c00 0x0 0x1000>;
	};

	syscfg_pctl_bm@10002800 {
		compatible = "mediatek,pctl-bm-syscfg", "syscon";
		linux,phandle = <0x13>;
		phandle = <0x13>;
		reg = <0x0 0x10002800 0x0 0x1000>;
	};

	syscfg_pctl_lb@10002400 {
		compatible = "mediatek,pctl-lb-syscfg", "syscon";
		linux,phandle = <0x11>;
		phandle = <0x11>;
		reg = <0x0 0x10002400 0x0 0x1000>;
	};

	syscfg_pctl_lm@10002200 {
		compatible = "mediatek,pctl-lm-syscfg", "syscon";
		linux,phandle = <0x10>;
		phandle = <0x10>;
		reg = <0x0 0x10002200 0x0 0x1000>;
	};

	syscfg_pctl_lt@10002000 {
		compatible = "mediatek,pctl-lt-syscfg", "syscon";
		linux,phandle = <0xf>;
		phandle = <0xf>;
		reg = <0x0 0x10002000 0x0 0x1000>;
	};

	syscfg_pctl_rb@10002a00 {
		compatible = "mediatek,pctl-rb-syscfg", "syscon";
		linux,phandle = <0x14>;
		phandle = <0x14>;
		reg = <0x0 0x10002a00 0x0 0x1000>;
	};

	therm_ctrl@1100b000 {
		clock-names = "therm-main";
		clocks = <0x19 0x8>;
		compatible = "mediatek,therm_ctrl";
		interrupts = <0x0 0x4e 0x8>;
		reg = <0x0 0x1100b000 0x0 0x1000>;
	};

	timer {
		clock-frequency = <0xc65d40>;
		compatible = "arm,armv8-timer";
		interrupt-parent = <0x2>;
		interrupts = <0x1 0xd 0x8 0x1 0xe 0x8 0x1 0xb 0x8 0x1 0xa 0x8>;
	};

	topckgen@10000000 {
		#clock-cells = <0x1>;
		compatible = "mediatek,topckgen", "syscon";
		linux,phandle = <0x24>;
		phandle = <0x24>;
		reg = <0x0 0x10000000 0x0 0x1000 0x0 0x1000c000 0x0 0x1000>;
	};

	topckgen_ao@1001b000 {
		compatible = "mediatek,topckgen_ao";
		reg = <0x0 0x1001b000 0x0 0x1000>;
	};

	topmisc@10011000 {
		compatible = "mediatek,topmisc";
		reg = <0x0 0x10011000 0x0 0x1000>;
	};

	toprgu@10007000 {
		compatible = "mediatek,toprgu";
		interrupts = <0x0 0x8b 0x0>;
		reg = <0x0 0x10007000 0x0 0x1000>;
	};

	touch {
		compatible = "mediatek,mt6739-touch";
		linux,phandle = <0x4f>;
		phandle = <0x4f>;
	};

	trng@1020f000 {
		compatible = "mediatek,trng";
		interrupts = <0x0 0xa1 0x8>;
		reg = <0x0 0x1020f000 0x0 0x1000>;
	};

	trusty {
		#address-cells = <0x2>;
		#size-cells = <0x2>;
		compatible = "android,trusty-smc-v1";
		ranges;

		irq {
			compatible = "android,trusty-irq-v1";
			ppi-interrupt-parent = <0x2>;
		};

		log {
			compatible = "android,trusty-log-v1";
		};

		mtee {
			compatible = "mediatek,trusty-mtee-v1";
		};

		virtio {
			compatible = "android,trusty-virtio-v1";
		};
	};

	usb0@11200000 {
		clock-names = "usb0", "usb0_clk_top_sel", "usb0_clk_univpll3_d4";
		clocks = <0x19 0x6 0x24 0x3c 0x24 0x1e>;
		compatible = "mediatek,mt6739-usb20";
		interrupts = <0x0 0x49 0x8>;
		mode = <0x2>;
		multipoint = <0x1>;
		num_eps = <0x10>;
		reg = <0x0 0x11200000 0x0 0x10000 0x0 0x11cc0000 0x0 0x10000>;
	};

	utos {
		compatible = "microtrust,utos";
		interrupts = <0x0 0x83 0x1 0x0 0x84 0x1>;
	};

	vdec@17040000 {
		compatible = "mediatek,vdec";
		interrupts = <0x0 0xd7 0x8>;
		reg = <0x0 0x17040000 0x0 0x10000>;
	};

	vdec_gcon@17000000 {
		clock-names = "MT_CG_VDEC", "MT_CG_VENC", "MT_SCP_SYS_VDE", "MT_SCP_SYS_VEN";
		clocks = <0x37 0x3 0x37 0x1 0x1a 0x6 0x1a 0x6>;
		compatible = "mediatek,vdec_gcon";
		reg = <0x0 0x17000000 0x0 0x1000>;
	};

	venc@17020000 {
		compatible = "mediatek,venc";
		interrupts = <0x0 0xd4 0x8>;
		linux,phandle = <0x56>;
		phandle = <0x56>;
		reg = <0x0 0x17020000 0x0 0x1000>;
	};

	venc_global_con@17000000 {
		#clock-cells = <0x1>;
		compatible = "mediatek,venc_global_con", "syscon";
		linux,phandle = <0x37>;
		phandle = <0x37>;
		reg = <0x0 0x17000000 0x0 0x10000>;
	};

	venc_jpg@17030000 {
		clock-names = "MT_CG_VENC_JPGENC";
		clocks = <0x37 0x2>;
		compatible = "mediatek,venc_jpg";
		interrupts = <0x0 0xd6 0x8>;
		reg = <0x0 0x17030000 0x0 0x1000>;
	};

	wifi@180f0000 {
		clock-names = "wifi-dma";
		clocks = <0x19 0x28>;
		compatible = "mediatek,wifi";
		dma_addrmask = <0x24>;
		interrupts = <0x0 0xea 0x8>;
		reg = <0x0 0x180f0000 0x0 0x5c>;
	};
};
